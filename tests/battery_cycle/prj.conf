## CMakeLists.txt
```
#
# Copyright (c) 2026 Seeed Technology Co., Ltd.
#
# SPDX-License-Identifier: LicenseRef-Nordic-5-Clause
#

cmake_minimum_required(VERSION 3.20.0)

find_package(Zephyr REQUIRED HINTS $ENV{ZEPHYR_BASE})
project(battery_cycle)

target_sources(app PRIVATE
	src/main.c
	src/re_test.c
	src/ble.c
	src/wifi.c
	src/button.c
	src/sdcard.c
	src/mic.c
	src/oled.c
	src/pmic.c
	src/motor.c
	src/imu.c
	src/flash_test.c
	src/discharge.c
)
```

## sysbuild.conf
```
#
# Copyright (c) 2024 Seeed Studio
#
# SPDX-License-Identifier: LicenseRef-Nordic-5-Clause
#

# Battery charge/discharge cycle test firmware — flashed directly via J-Link,
# no MCUboot bootloader. (Ported from the re-discharge branch's tests/re.)
SB_CONFIG_BOOTLOADER_NONE=y
SB_CONFIG_SECURE_BOOT_NETCORE=n

# Disable the Partition Manager so this no-mcuboot image links at 0x0 instead
# of inheriting the board pm_static (which reserves 0x0 for mcuboot ->
# app@0x16200, 0x0 empty -> no boot). Same pattern as the other clip tests.
SB_CONFIG_PARTITION_MANAGER=n

# Enable WiFi nRF70 (the discharge TX load) + the NET core BLE HCI IPC.
SB_CONFIG_WIFI_NRF70=y
SB_CONFIG_NETCORE_IPC_RADIO=y
SB_CONFIG_NETCORE_IPC_RADIO_BT_HCI_IPC=y
```

## prj.conf
```kconfig
#
# Copyright (c) 2023 Nordic Semiconductor ASA
#
# SPDX-License-Identifier: LicenseRef-Nordic-5-Clause
#

# DMIC (Digital Microphone)
CONFIG_AUDIO=y
CONFIG_AUDIO_DMIC=y

# GPIO button input driver
CONFIG_INPUT=y
CONFIG_INPUT_GPIO_BUTTON_OWN_THREAD=y
CONFIG_INPUT_GPIO_BUTTON_THREAD_STACK_SIZE=1024
CONFIG_GPIO_BUTTON=y

# SD Card and File System
CONFIG_DISK_ACCESS=y
CONFIG_DISK_DRIVER_SDMMC=y
CONFIG_FILE_SYSTEM=y
CONFIG_FAT_FILESYSTEM_ELM=y
CONFIG_FS_FATFS_LFN=y
CONFIG_FS_FATFS_MKFS=y
CONFIG_FILE_SYSTEM_MKFS=y

# SPI Flash
CONFIG_FLASH=y
CONFIG_FLASH_MAP=y

# WiFi AP mode
CONFIG_WIFI=y
CONFIG_WIFI_NRF70=y
CONFIG_NRF70_AP_MODE=y
CONFIG_WIFI_NM_WPA_SUPPLICANT=y
CONFIG_WIFI_NM_WPA_SUPPLICANT_AP=y
CONFIG_WIFI_NM_WPA_SUPPLICANT_LOG_LEVEL_INF=n
CONFIG_WIFI_RANDOM_MAC_ADDRESS=y

# WiFi and BLE coexistence
CONFIG_NRF70_SR_COEX=y
CONFIG_WIFI_READY_LIB=y
CONFIG_NRF_WIFI_IF_AUTO_START=n

# Reduce memory usage - fewer buffers
CONFIG_NRF70_RX_NUM_BUFS=8
CONFIG_NRF70_MAX_TX_AGGREGATION=2

# RPU power-save idle timeout (kept long: during the discharge phase the TX
# load keeps the radio busy anyway; during the charge phase the WiFi interface
# is brought fully down so the radio powers off regardless of this timeout).
CONFIG_NRF70_RPU_PS_IDLE_TIMEOUT_MS=3600000

# Drop the nRF5340<->nRF70 QSPI link to low power when WiFi is not in use
# (i.e. during the charge phase, once the interface is down) -- minimum WiFi
# power draw so the cell charges faster.
CONFIG_NRF70_QSPI_LOW_POWER=y

# WiFi credentials - not needed for AP mode
CONFIG_WIFI_CREDENTIALS=n

# Disable WPA3/SAE - WPA2-PSK only (v3.3.0: WPA3 is now a choice)
CONFIG_WIFI_NM_WPA_SUPPLICANT_WPA3_IMPLEMENTATION_NONE=y

# WiFi memory
CONFIG_NRF_WIFI_CTRL_HEAP_SIZE=20000
CONFIG_NRF_WIFI_DATA_HEAP_SIZE=53000
CONFIG_WIFI_NM_WPA_SUPPLICANT_THREAD_STACK_SIZE=10240

# zperf for throughput testing
CONFIG_NET_ZPERF=y

# Networking Management API
CONFIG_NET_MGMT=y
CONFIG_NET_MGMT_EVENT=y

# AP static IP
CONFIG_NET_CONFIG_SETTINGS=y
CONFIG_NET_CONFIG_INIT_TIMEOUT=0
CONFIG_NET_CONFIG_MY_IPV4_ADDR="192.168.4.1"
CONFIG_NET_CONFIG_MY_IPV4_NETMASK="255.255.255.0"
CONFIG_NET_CONFIG_MY_IPV4_GW="192.168.4.1"

# DHCP server for AP clients
CONFIG_NET_DHCPV4=y
CONFIG_NET_DHCPV4_SERVER=y
CONFIG_NET_DHCPV4_SERVER_ADDR_COUNT=1

# Shell - minimal
CONFIG_SHELL=y
CONFIG_SHELL_BACKEND_SERIAL=y
CONFIG_NET_SHELL=n
CONFIG_WIFI_CREDENTIALS_SHELL=n
CONFIG_NET_L2_WIFI_SHELL=n

# Filesystem shell commands
CONFIG_FILE_SYSTEM_SHELL=y

# Flash and Regulator shell commands
CONFIG_FLASH_SHELL=y
CONFIG_REGULATOR=y
CONFIG_REGULATOR_SHELL=y
CONFIG_GPIO_SHELL=y

# Sensor (for PMIC battery/charger monitoring)
CONFIG_SENSOR=y

# nRF Fuel Gauge (Coulomb-counting SoC, stable under the WiFi TX discharge
# load where voltage_to_soc jumps on transient sag). Same config as the clip
# app; model is src/battery_model.inc (the 240-cell HSZ 362123 model).
CONFIG_NRF_FUEL_GAUGE=y
CONFIG_NRF_FUEL_GAUGE_VARIANT_SECONDARY_CELL=y

# I2C and I2C shell commands
CONFIG_I2C=y
CONFIG_I2C_SHELL=y

# Shell stack size - increased for WiFi operations
CONFIG_SHELL_STACK_SIZE=4096

# Logging - minimal, use thread mode to reduce impact
CONFIG_LOG=y
CONFIG_LOG_DEFAULT_LEVEL=3
CONFIG_LOG_BACKEND_UART=y
CONFIG_LOG_BACKEND_RTT=n
# CONFIG_LOG_MODE_IMMEDIATE is not set - use threaded mode

# System settings
CONFIG_NEWLIB_LIBC=y
CONFIG_NEWLIB_LIBC_NANO=n

# Minimal networking - UDP only
CONFIG_NETWORKING=y
CONFIG_NET_SOCKETS=y
CONFIG_NET_SOCKETS_POLL_MAX=4
CONFIG_NET_L2_ETHERNET=y
CONFIG_NET_L2_WIFI_MGMT=y
CONFIG_NET_IPV4=y
CONFIG_NET_IPV6=n
CONFIG_NET_UDP=y
CONFIG_NET_TCP=n

# mbedTLS - use nRF security library instead of builtin
CONFIG_MBEDTLS=y
CONFIG_MBEDTLS_LEGACY_CRYPTO_C=n

# Memory optimization - reduced for RAM efficiency
CONFIG_SYSTEM_WORKQUEUE_STACK_SIZE=6144
CONFIG_MAIN_STACK_SIZE=6144

# Heap size for WiFi/crypto operations
CONFIG_HEAP_MEM_POOL_SIZE=120000

CONFIG_MBEDTLS_HEAP_SIZE=1024

# Network buffers (balanced for stability)
CONFIG_NET_TC_TX_COUNT=2
CONFIG_NET_BUF_TX_COUNT=14
CONFIG_NET_BUF_RX_COUNT=14
CONFIG_NET_PKT_TX_COUNT=6
CONFIG_NET_PKT_RX_COUNT=6
CONFIG_NET_TX_STACK_SIZE=4096
CONFIG_NET_RX_STACK_SIZE=4096

CONFIG_NET_BUF_FIXED_DATA_SIZE=y
CONFIG_NET_BUF_DATA_SIZE=512

# DHCP
CONFIG_NET_DHCPV4=y

CONFIG_WIFI_RANDOM_MAC_ADDRESS=y
CONFIG_BT=y
CONFIG_BT_PERIPHERAL=y
CONFIG_BT_DEVICE_NAME="Clip_Test"
CONFIG_BT_MAX_CONN=1
CONFIG_BT_SMP=y
CONFIG_BT_SIGNING=y
CONFIG_BT_GATT_CLIENT=y

# BLE throughput optimization
CONFIG_BT_BUF_ACL_RX_SIZE=251
CONFIG_BT_BUF_ACL_TX_SIZE=251
CONFIG_BT_L2CAP_TX_MTU=247
CONFIG_BT_CTLR_DATA_LENGTH_MAX=251

# Increase thread priority for BLE operations
CONFIG_BT_RX_STACK_SIZE=2048

# Display support (OLED CH1115)
CONFIG_DISPLAY=y
CONFIG_GPIO=y

# USB Mass Storage (expose SD card as USB drive)
CONFIG_USB_DEVICE_STACK_NEXT=y
CONFIG_USBD_MSC_CLASS=y
CONFIG_USBD_MSC_LUNS_PER_INSTANCE=1
CONFIG_USBD_MSC_DOUBLE_BUFFERING=n
CONFIG_USBD_MSC_SCSI_BUFFER_SIZE=512
CONFIG_HWINFO=y

# Reboot command
CONFIG_REBOOT=y
```

## src/main.c
```c
/*
 * Copyright (c) 2026 Seeed Technology Co., Ltd.
 *
 * SPDX-License-Identifier: LicenseRef-Nordic-5-Clause
 */

#include <zephyr/kernel.h>
#include <zephyr/logging/log.h>

#include "button.h"
#include "sdcard.h"
#include "oled.h"
#include "pmic.h"
#include "motor.h"
#include "mic.h"
#include "wifi.h"
#include "ble.h"
#include "re_test.h"
#include "discharge.h"

LOG_MODULE_REGISTER(main, LOG_LEVEL_INF);

int main(void)
{
	int ret;

	printk("=== Battery Cycle Test ===\n");
	printk("Battery charge/discharge cycle test\n\n");

	/* Initialize peripherals */
	ret = button_init();
	if (ret != 0) {
		LOG_WRN("Button init failed: %d", ret);
	}

	ret = sdcard_init();
	if (ret != 0) {
		LOG_WRN("SD card init failed: %d", ret);
	}

	ret = mic_init();
	if (ret != 0) {
		LOG_WRN("MIC init failed: %d", ret);
	}

	ret = oled_init();
	if (ret != 0) {
		LOG_WRN("OLED init failed: %d", ret);
	}

	ret = pmic_init();
	if (ret != 0) {
		LOG_WRN("PMIC init failed: %d", ret);
	}

	ret = motor_init();
	if (ret != 0) {
		LOG_WRN("Motor init failed: %d", ret);
	}

	/* Start WiFi AP */
	ret = wifi_run_test();
	if (ret != 0) {
		LOG_WRN("WiFi init failed: %d", ret);
	}

	/* Start the continuous UDP TX discharge load (auto-starts, waits for AP) */
	wifi_discharge_start();

	/* Start BLE advertising */
	ret = ble_init();
	if (ret != 0) {
		LOG_WRN("BLE init failed: %d", ret);
	}

	printk("All peripherals initialized\n");
	printk("Starting battery discharge/charge cycle test...\n\n");

	/* Run the battery discharge/charge cycle test (never returns) */
	discharge_run();

	return 0;
}
```

## src/button.c
```c
/*
 * Copyright (c) 2026 Seeed Technology Co., Ltd.
 *
 * SPDX-License-Identifier: LicenseRef-Nordic-5-Clause
 */

#include <zephyr/kernel.h>
#include <zephyr/device.h>
#include <zephyr/drivers/input/button.h>
#include <zephyr/logging/log.h>
#include "button.h"
#include "pmic.h"

LOG_MODULE_REGISTER(button, LOG_LEVEL_INF);

static void button_event_cb(const struct device *dev, enum button_action action)
{
	switch (action) {
	case BUTTON_DOUBLE_CLICK:
		LOG_INF("Double click — entering ship mode");
		pmic_enter_ship_mode();
		LOG_ERR("Ship mode failed");
		break;
	case BUTTON_SINGLE_CLICK:
		LOG_INF("Button click");
		break;
	default:
		break;
	}
}

int button_init(void)
{
	const struct device *btn = DEVICE_DT_GET(DT_ALIAS(sw0));
	int ret;

	if (!device_is_ready(btn)) {
		LOG_ERR("Button device not ready");
		return -ENODEV;
	}

	ret = button_callback_register(btn, button_event_cb);
	if (ret < 0) {
		LOG_ERR("Button callback register failed: %d", ret);
		return ret;
	}

	LOG_INF("Button ready (double click = ship mode)");

	return 0;
}
```

## src/discharge.c
```c
/*
 * Copyright (c) 2026 Seeed Technology Co., Ltd.
 *
 * SPDX-License-Identifier: LicenseRef-Nordic-5-Clause
 *
 * Battery discharge/charge cycle test state machine. Polls the NPM1300
 * charger every few seconds, drives the charger enable to alternate between
 * discharging (WiFi TX load drains the cell) and charging, and keeps the
 * OLED updated with % / state / voltage. The displayed % comes from the nRF
 * Fuel Gauge (stable under the pulsed WiFi TX load); the charge/discharge
 * *switching* is deliberately voltage-based for clean hysteresis around the
 * cell's knee voltages.
 */

#include <zephyr/kernel.h>
#include <zephyr/logging/log.h>
#include <stdio.h>
#include "discharge.h"
#include "pmic.h"
#include "oled.h"
#include "wifi.h"
#include "sdcard.h"

LOG_MODULE_REGISTER(discharge, LOG_LEVEL_INF);

/* Voltage-hysteresis thresholds (cell voltage, not fuel-gauge SoC):
 *  - DISCHARGE -> CHARGE when the cell sinks to 3.5 V,
 *  - CHARGE    -> DISCHARGE when the cell rises to 4.12 V.
 * The 3.5 V floor stays above the ~3.3 V point where BUCK2 can no longer hold
 * the 3.3 V rail (buck dropout) and WiFi brownouts, with headroom for the
 * transient voltage sag under the WiFi TX load. The 0.62 V gap prevents
 * oscillation around the switching point. */
#define DISCHARGE_VOLTAGE_MV		3500U	/* start charging at/below */
#define CHARGE_VOLTAGE_MV		4120U	/* start discharging at/above */
/* Control-loop poll interval. The cycle is voltage-driven, so this sets how
 * often the state machine re-reads the cell voltage and re-evaluates the
 * charge/discharge switch + refreshes the OLED. 1 s makes the display and
 * threshold-crossing response feel live (was 5 s). The cell voltage moves
 * slowly, so going below ~500 ms just adds I2C/OLED traffic for no benefit. */
#define POLL_INTERVAL_MS		1000U

/* High-temperature charge cutoff (software hysteresis). The NPM1300 HW hot
 * threshold (thermistor-hot-millidegrees=45C in the board DTS) inhibits
 * charging autonomously, but the NTC path has no register hysteresis, so a
 * cell resting at ~45C would oscillate charge on/off. Software latches OFF
 * at STOP and re-enables at RESUME (5C gap). Matches the clip app. Active
 * only during CHARGE (during DISCHARGE the charger is already off). */
#define CHARGE_STOP_TEMP_C		45	/* stop charging at/above */
#define CHARGE_RESUME_TEMP_C		40	/* resume charging below */

enum cycle_state {
	STATE_DISCHARGE,
	STATE_CHARGE,
};

void discharge_run(void)
{
	enum cycle_state state = STATE_DISCHARGE;
	uint32_t cycles = 0U;
	uint8_t pct = 0U;
	uint32_t mv = 0U;
	int32_t temp = 0;
	bool charging = false;
	bool thermal_charge_disabled = false;  /* sticky: latched hot, held off until resume */

	printk("\n=== Battery discharge/charge cycle test ===\n");
	printk("Discharging to %u mV, then charging to %u mV, repeat.\n\n",
	       DISCHARGE_VOLTAGE_MV, CHARGE_VOLTAGE_MV);

	/* Start in DISCHARGE: charger off, WiFi TX + SD read loads on. */
	pmic_charger_set(false);
	wifi_discharge_load_enable(true);
	sdcard_discharge_load_enable(true);

	for (;;) {
		int ret = pmic_get_battery_status(&mv, &pct, &charging, &temp);
		const char *label = (state == STATE_DISCHARGE) ?
				    "DISCHARGE" : "CHARGE";

		if (ret == 0) {
			oled_show_battery(pct, charging, mv, temp, label, cycles);

			if (state == STATE_DISCHARGE) {
				if (mv <= DISCHARGE_VOLTAGE_MV) {
					LOG_INF("cycle %u: %u mV reached -> CHARGE",
						cycles, mv);
					state = STATE_CHARGE;
					/* Charge with minimal load: WiFi off
					 * (AP down + TX idle) + SD read off. */
					wifi_discharge_load_enable(false);
					sdcard_discharge_load_enable(false);
					pmic_charger_set(true);
				}
			} else { /* STATE_CHARGE */
				if (mv >= CHARGE_VOLTAGE_MV) {
					cycles++;
					LOG_INF("cycle %u: %u mV reached -> DISCHARGE",
						cycles, mv);
					state = STATE_DISCHARGE;
					pmic_charger_set(false);
					wifi_discharge_load_enable(true);
					sdcard_discharge_load_enable(true);
				}
			}

			/* Thermal charge gating (software hysteresis). The HW
			 * NPM1300 hot threshold (45C, board DTS) is the
			 * autonomous safety net; this adds the 5C resume gap the
			 * NTC path lacks so a cell at ~45C doesn't oscillate.
			 * Active only during CHARGE. */
			if (state == STATE_CHARGE) {
				if (temp >= CHARGE_STOP_TEMP_C && !thermal_charge_disabled) {
					pmic_charger_set(false);
					thermal_charge_disabled = true;
					LOG_WRN("Thermal: charge off (temp %dC >= %dC)",
						(int)temp, CHARGE_STOP_TEMP_C);
				} else if (thermal_charge_disabled &&
					   temp <= CHARGE_RESUME_TEMP_C) {
					pmic_charger_set(true);
					thermal_charge_disabled = false;
					LOG_INF("Thermal: charge resume (temp %dC <= %dC)",
						(int)temp, CHARGE_RESUME_TEMP_C);
				}
			}
		} else {
			LOG_WRN("battery read failed: %d", ret);
		}

		k_sleep(K_MSEC(POLL_INTERVAL_MS));
	}
}
```

## src/imu.c
```c
/*
 * Copyright (c) 2023 Nordic Semiconductor ASA
 *
 * SPDX-License-Identifier: LicenseRef-Nordic-5-Clause
 */

#include <stdlib.h>
#include <zephyr/kernel.h>
#include <zephyr/device.h>
#include <zephyr/drivers/gpio.h>
#include <zephyr/shell/shell.h>
#include <zephyr/logging/log.h>
#include "imu.h"

LOG_MODULE_REGISTER(imu, LOG_LEVEL_INF);

/* IMU I2C address - will be auto-detected */
static uint8_t lsm6ds3_i2c_addr = 0x6A;  /* Default: SA0=0 */
#define LSM6DS3_I2C_ADDR_ALT    0x6B  /* SA0=1 */

/* Software I2C GPIO pins */
#define I2C_SDA_GPIO    0  /* GPIO1.0 */
#define I2C_SCL_GPIO    1  /* GPIO1.1 */

/* IMU power control GPIO */
#define IMU_PWR_GPIO    2  /* GPIO0.2 (NFC1) */

/* GPIO devices */
static const struct device *gpio0_dev = DEVICE_DT_GET(DT_NODELABEL(gpio0));
static const struct device *gpio1_dev = DEVICE_DT_GET(DT_NODELABEL(gpio1));

/* I2C timing delays (for 50kHz approximately, more stable) */
#define I2C_DELAY_US    10

/* LSM6DS3 Register Map */
#define LSM6DS3_REG_WHO_AM_I    0x0F
#define LSM6DS3_REG_CTRL1_XL    0x10  /* accelerometer control */
#define LSM6DS3_REG_CTRL2_G     0x11  /* gyroscope control */
#define LSM6DS3_REG_CTRL9_XL    0x19  /* MEMS control */
#define LSM6DS3_REG_CTRL10_C    0x1A  /* MEMS control */
#define LSM6DS3_REG_OUTX_L_XL  0x28  /* accel X low */
#define LSM6DS3_REG_OUTX_H_XL  0x29  /* accel X high */
#define LSM6DS3_REG_OUTY_L_XL  0x2A  /* accel Y low */
#define LSM6DS3_REG_OUTY_H_XL  0x2B  /* accel Y high */
#define LSM6DS3_REG_OUTZ_L_XL  0x2C  /* accel Z low */
#define LSM6DS3_REG_OUTZ_H_XL  0x2D  /* accel Z high */
#define LSM6DS3_REG_OUTX_L_G   0x22  /* gyro X low */
#define LSM6DS3_REG_OUTX_H_G   0x23  /* gyro X high */
#define LSM6DS3_REG_OUTY_L_G   0x24  /* gyro Y low */
#define LSM6DS3_REG_OUTY_H_G   0x25  /* gyro Y high */
#define LSM6DS3_REG_OUTZ_L_G   0x26  /* gyro Z low */
#define LSM6DS3_REG_OUTZ_H_G   0x27  /* gyro Z high */

/* IMU power state */
static bool imu_powered = false;

/* Software I2C implementation */
static void i2c_delay(void)
{
	k_usleep(I2C_DELAY_US);
}

static void i2c_scl_high(void)
{
	gpio_port_set_masked_raw(gpio1_dev, BIT(I2C_SCL_GPIO), BIT(I2C_SCL_GPIO));
	i2c_delay();
}

static void i2c_scl_low(void)
{
	gpio_port_set_masked_raw(gpio1_dev, BIT(I2C_SCL_GPIO), 0);
	i2c_delay();
}

static void i2c_sda_high(void)
{
	gpio_port_set_masked_raw(gpio1_dev, BIT(I2C_SDA_GPIO), BIT(I2C_SDA_GPIO));
	i2c_delay();
}

static void i2c_sda_low(void)
{
	gpio_port_set_masked_raw(gpio1_dev, BIT(I2C_SDA_GPIO), 0);
	i2c_delay();
}

static void i2c_start(void)
{
	/* Ensure SCL is low first */
	i2c_scl_low();

	/* SDA high to low transition while SCL is high (START condition) */
	i2c_sda_high();
	k_usleep(1);
	i2c_scl_high();
	k_usleep(1);
	i2c_sda_low();
	k_usleep(1);

	/* Pull SCL low to prepare for data */
	i2c_scl_low();
}

static void i2c_stop(void)
{
	/* Ensure SCL is low first */
	i2c_scl_low();

	/* SDA low to high transition while SCL is high (STOP condition) */
	i2c_sda_low();
	k_usleep(1);
	i2c_scl_high();
	k_usleep(1);
	i2c_sda_high();
	k_usleep(1);

	/* Return to idle state */
	i2c_scl_low();
}

static void i2c_send_bit(uint8_t bit)
{
	/* Set SDA value while SCL is low */
	if (bit) {
		i2c_sda_high();
	} else {
		i2c_sda_low();
	}

	/* Small delay to ensure SDA is stable */
	k_usleep(1);

	/* Pulse SCL high */
	i2c_scl_high();
	i2c_delay();

	/* Bring SCL low */
	i2c_scl_low();
	i2c_delay();
}

static uint8_t i2c_read_bit(void)
{
	gpio_port_value_t port_value;
	uint8_t bit;

	/* Configure SDA as input for reading */
	gpio_pin_configure(gpio1_dev, I2C_SDA_GPIO, GPIO_INPUT);

	/* Small delay to let line settle */
	k_usleep(1);

	/* Read SDA while SCL is high */
	gpio_port_get_raw(gpio1_dev, &port_value);
	bit = (port_value & BIT(I2C_SDA_GPIO)) != 0;

	/* Restore SDA as output */
	gpio_pin_configure(gpio1_dev, I2C_SDA_GPIO, GPIO_OUTPUT);

	/* Now toggle SCL */
	i2c_scl_high();
	i2c_delay();
	i2c_scl_low();

	return bit;
}

static uint8_t i2c_send_byte(uint8_t byte)
{
	uint8_t ack;
	uint8_t i;

	for (i = 0; i < 8; i++) {
		i2c_send_bit(byte & 0x80);
		byte <<= 1;
	}

	ack = !i2c_read_bit();  /* ACK is active low */
	return ack;
}

static uint8_t i2c_read_byte(uint8_t ack)
{
	uint8_t byte = 0;
	uint8_t i;

	for (i = 0; i < 8; i++) {
		byte <<= 1;
		byte |= i2c_read_bit();
	}

	i2c_send_bit(!ack);  /* Send ACK (or NACK) */
	return byte;
}

/* Read IMU register */
static int imu_read_reg(uint8_t reg, uint8_t *value)
{
	int ret;

	i2c_start();
	ret = i2c_send_byte((lsm6ds3_i2c_addr << 1) | 0);  /* Write address */
	if (!ret) {
		i2c_stop();
		return -EIO;
	}

	ret = i2c_send_byte(reg);  /* Register address */
	if (!ret) {
		i2c_stop();
		return -EIO;
	}

	i2c_start();
	ret = i2c_send_byte((lsm6ds3_i2c_addr << 1) | 1);  /* Read address */
	if (!ret) {
		i2c_stop();
		return -EIO;
	}

	*value = i2c_read_byte(0);  /* Read byte with NACK */
	i2c_stop();

	return 0;
}

/* Write IMU register */
static int imu_write_reg(uint8_t reg, uint8_t value)
{
	int ret;

	i2c_start();
	ret = i2c_send_byte((lsm6ds3_i2c_addr << 1) | 0);  /* Write address */
	if (!ret) {
		i2c_stop();
		return -EIO;
	}

	ret = i2c_send_byte(reg);  /* Register address */
	if (!ret) {
		i2c_stop();
		return -EIO;
	}

	ret = i2c_send_byte(value);  /* Data */
	i2c_stop();

	if (!ret) {
		return -EIO;
	}

	return 0;
}

/* Simple I2C scan to check for any devices on the bus */
static void i2c_scan_bus(void)
{
	uint8_t addr;
	int ack_count = 0;

	LOG_INF("Scanning I2C bus for devices...");

	for (addr = 0x08; addr < 0x78; addr++) {
		i2c_start();
		if (i2c_send_byte((addr << 1) | 0)) {  /* Try write address */
			ack_count++;
			LOG_INF("  Device found at 0x%02X", addr);
		}
		i2c_stop();
	}

	if (ack_count == 0) {
		LOG_WRN("No I2C devices found on bus");
	} else {
		LOG_INF("Total devices found: %d", ack_count);
	}
}

/* Initialize software I2C GPIO pins */
static int i2c_soft_init(void)
{
	int ret;

	if (!device_is_ready(gpio1_dev)) {
		LOG_ERR("GPIO1 not ready");
		return -ENODEV;
	}

	LOG_INF("Configuring GPIO1.0 (SDA) and GPIO1.1 (SCL) for software I2C...");

	/* Configure SDA and SCL as open-drain outputs (I2C standard)
	 * Note: If open-drain is not available, use regular output with pull-up */
	ret = gpio_pin_configure(gpio1_dev, I2C_SDA_GPIO,
				 GPIO_OUTPUT | GPIO_PULL_UP);
	if (ret != 0 && ret != -EEXIST) {
		LOG_ERR("Failed to configure SDA GPIO: %d", ret);
		return ret;
	}

	ret = gpio_pin_configure(gpio1_dev, I2C_SCL_GPIO,
				 GPIO_OUTPUT | GPIO_PULL_UP);
	if (ret != 0 && ret != -EEXIST) {
		LOG_ERR("Failed to configure SCL GPIO: %d", ret);
		return ret;
	}

	/* Set idle state (both high) */
	i2c_sda_high();
	i2c_scl_high();

	LOG_INF("Software I2C GPIO pins configured (with pull-ups)");

	/* Small delay to let lines settle */
	k_sleep(K_MSEC(10));

	return 0;
}

/* Power on IMU */
static int imu_power_on(void)
{
	int ret;
	gpio_port_value_t port_value;

	if (!device_is_ready(gpio0_dev)) {
		LOG_ERR("GPIO0 not ready");
		return -ENODEV;
	}

	LOG_INF("Powering on IMU via GPIO0.%d...", IMU_PWR_GPIO);

	/* Configure power GPIO as output */
	ret = gpio_pin_configure(gpio0_dev, IMU_PWR_GPIO, GPIO_OUTPUT);
	if (ret != 0 && ret != -EEXIST) {
		LOG_ERR("Failed to configure power GPIO: %d", ret);
		return ret;
	}

	/* Set power on */
	gpio_port_set_masked_raw(gpio0_dev, BIT(IMU_PWR_GPIO), BIT(IMU_PWR_GPIO));

	/* Verify the GPIO state */
	gpio_port_get_raw(gpio0_dev, &port_value);
	LOG_INF("GPIO0.%d set to 1, port value = 0x%08X", IMU_PWR_GPIO, port_value);

	/* Wait for IMU to power up (increased from 50ms to 100ms) */
	k_sleep(K_MSEC(100));

	imu_powered = true;
	LOG_INF("IMU powered on");
	return 0;
}

/* Power off IMU */
static int imu_power_off(void)
{
	if (!device_is_ready(gpio0_dev)) {
		return -ENODEV;
	}

	gpio_port_set_masked_raw(gpio0_dev, BIT(IMU_PWR_GPIO), 0);

	imu_powered = false;
	LOG_INF("IMU powered off");
	return 0;
}

/* Check IMU presence via WHO_AM_I register - auto-detect I2C address */
static int imu_check_identity(void)
{
	uint8_t who_am_i;
	int ret;
	uint8_t addrs[] = {0x6A, 0x6B};
	int i;

	LOG_INF("Scanning for IMU on I2C bus...");

	for (i = 0; i < 2; i++) {
		lsm6ds3_i2c_addr = addrs[i];
		LOG_INF("  Trying I2C address 0x%02X...", lsm6ds3_i2c_addr);

		ret = imu_read_reg(LSM6DS3_REG_WHO_AM_I, &who_am_i);
		if (ret == 0) {
			LOG_INF("  Device found at 0x%02X, WHO_AM_I=0x%02X",
				lsm6ds3_i2c_addr, who_am_i);

			if (who_am_i == 0x6C) {
				LOG_INF("LSM6DS3 detected!");
				return 0;
			} else if (who_am_i == 0x6A) {
				/* LSM6DS3TR might return 0x6A */
				LOG_INF("LSM6DS3 variant detected (WHO_AM_I=0x6A)!");
				return 0;
			} else {
				LOG_WRN("Unexpected WHO_AM_I value");
			}
		} else {
			LOG_DBG("  No response at 0x%02X", addrs[i]);
		}
	}

	LOG_ERR("No IMU found at either address (0x6A, 0x6B)");
	return -ENODEV;
}

/* Initialize IMU with default configuration */
static int imu_init_config(void)
{
	int ret;

	LOG_INF("Initializing IMU...");

	/* Configure accelerometer: 104 Hz, +/- 4g */
	ret = imu_write_reg(LSM6DS3_REG_CTRL1_XL, 0x8A);  // ODR=104Hz, FS=±4g
	if (ret != 0) {
		LOG_ERR("Failed to write CTRL1_XL: %d", ret);
		return ret;
	}

	/* Configure gyroscope: 104 Hz, +/- 500dps */
	ret = imu_write_reg(LSM6DS3_REG_CTRL2_G, 0x48);  // ODR=104Hz, FS=±500dps
	if (ret != 0) {
		LOG_ERR("Failed to write CTRL2_G: %d", ret);
		return ret;
	}

	/* Enable XYZ axes for both sensors */
	ret = imu_write_reg(LSM6DS3_REG_CTRL9_XL, 0x38);  // enable accel XYZ
	if (ret != 0) {
		LOG_ERR("Failed to write CTRL9_XL: %d", ret);
		return ret;
	}

	ret = imu_write_reg(LSM6DS3_REG_CTRL10_C, 0x38);  // enable gyro XYZ
	if (ret != 0) {
		LOG_ERR("Failed to write CTRL10_C: %d", ret);
		return ret;
	}

	LOG_INF("IMU initialized: 104Hz, Accel±4g, Gyro±500dps");
	return 0;
}

/* Read sensor data */
static int imu_read_sensor_data(struct imu_data *data)
{
	uint8_t buf[6];
	int ret;
	int i;

	/* Read accelerometer data */
	ret = imu_write_reg(LSM6DS3_REG_OUTX_L_XL | 0x80, 0);  /* Auto-increment bit */
	if (ret != 0) {
		return ret;
	}

	/* Read 6 bytes */
	for (i = 0; i < 6; i++) {
		ret = imu_read_reg(LSM6DS3_REG_OUTX_L_XL + i, &buf[i]);
		if (ret != 0) {
			return ret;
		}
	}

	data->accel_x = (int16_t)((buf[1] << 8) | buf[0]);
	data->accel_y = (int16_t)((buf[3] << 8) | buf[2]);
	data->accel_z = (int16_t)((buf[5] << 8) | buf[4]);

	/* Read gyroscope data */
	ret = imu_write_reg(LSM6DS3_REG_OUTX_L_G | 0x80, 0);  /* Auto-increment bit */
	if (ret != 0) {
		return ret;
	}

	/* Read 6 bytes */
	for (i = 0; i < 6; i++) {
		ret = imu_read_reg(LSM6DS3_REG_OUTX_L_G + i, &buf[i]);
		if (ret != 0) {
			return ret;
		}
	}

	data->gyro_x = (int16_t)((buf[1] << 8) | buf[0]);
	data->gyro_y = (int16_t)((buf[3] << 8) | buf[2]);
	data->gyro_z = (int16_t)((buf[5] << 8) | buf[4]);

	return 0;
}

/* Public API */
int imu_init(void)
{
	int ret;

	LOG_INF("Initializing IMU (LSM6DS3)...");

	/* Initialize software I2C */
	ret = i2c_soft_init();
	if (ret != 0) {
		LOG_ERR("Software I2C initialization failed");
		return ret;
	}

	LOG_INF("  Software I2C ready (GPIO1.0=SDA, GPIO1.1=SCL)");

	/* Power on IMU */
	ret = imu_power_on();
	if (ret != 0) {
		return ret;
	}

	/* Scan I2C bus to see if any devices respond */
	i2c_scan_bus();

	/* Check IMU presence */
	ret = imu_check_identity();
	if (ret != 0) {
		imu_power_off();
		return ret;
	}

	/* Configure IMU */
	ret = imu_init_config();
	if (ret != 0) {
		imu_power_off();
		return ret;
	}

	LOG_INF("IMU ready");
	return 0;
}

int imu_read(struct imu_data *data)
{
	if (!imu_powered) {
		return -EIO;
	}

	return imu_read_sensor_data(data);
}

void imu_deinit(void)
{
	imu_power_off();
}

/* ============================================================================
 * Shell Commands
 * ============================================================================ */

/* Shell command: imu init */
static int cmd_imu_init(const struct shell *sh, size_t argc, char **argv)
{
	ARG_UNUSED(argc);
	ARG_UNUSED(argv);

	int ret = imu_init();

	if (ret == 0) {
		shell_print(sh, "IMU initialized successfully");
	} else {
		shell_print(sh, "Error: IMU initialization failed (%d)", ret);
	}

	return ret;
}

/* Shell command: imu read */
static int cmd_imu_read(const struct shell *sh, size_t argc, char **argv)
{
	struct imu_data data;
	int ret;

	if (!imu_powered) {
		shell_print(sh, "Error: IMU not powered. Run 'imu init' first");
		return -EIO;
	}

	ret = imu_read(&data);
	if (ret == 0) {
		shell_print(sh, "Sensor data:");
		shell_print(sh, "  Accel: X=%6d, Y=%6d, Z=%6d",
			   data.accel_x, data.accel_y, data.accel_z);
		shell_print(sh, "  Gyro:  X=%6d, Y=%6d, Z=%6d",
			   data.gyro_x, data.gyro_y, data.gyro_z);
	} else {
		shell_print(sh, "Error: Failed to read sensor data (%d)", ret);
	}

	return ret;
}

/* Shell command: imu monitor */
static int cmd_imu_monitor(const struct shell *sh, size_t argc, char **argv)
{
	int iterations = 0;
	int max_iter = 10;

	if (argc >= 2) {
		max_iter = strtol(argv[1], NULL, 10);
		if (max_iter <= 0) {
			shell_print(sh, "Usage: imu monitor [iterations]");
			return -EINVAL;
		}
	}

	if (!imu_powered) {
		shell_print(sh, "Error: IMU not powered. Run 'imu init' first");
		return -EIO;
	}

	shell_print(sh, "Monitoring IMU data (Ctrl+C to stop)...");

	while (iterations < max_iter) {
		struct imu_data data;

		if (imu_read(&data) == 0) {
			shell_print(sh, "[%2d] Accel:(%6d,%6d,%6d) Gyro:(%6d,%6d,%6d)",
				   iterations + 1,
				   data.accel_x, data.accel_y, data.accel_z,
				   data.gyro_x, data.gyro_y, data.gyro_z);
		}

		iterations++;
		k_sleep(K_MSEC(500));
	}

	shell_print(sh, "Monitoring stopped (%d iterations)", iterations);
	return 0;
}

/* Shell command: imu selftest */
static int cmd_imu_selftest(const struct shell *sh, size_t argc, char **argv)
{
	ARG_UNUSED(argc);
	ARG_UNUSED(argv);

	if (!imu_powered) {
		shell_print(sh, "Error: IMU not powered. Run 'imu init' first");
		return -EIO;
	}

	shell_print(sh, "IMU self-test...");
	shell_print(sh, "  Device: LSM6DS3 detected");
	shell_print(sh, "  Communication: OK");
	shell_print(sh, "  Sensors: Configured");
	shell_print(sh, "  Status: Ready");

	return 0;
}

/* Shell command: imu scan */
static int cmd_imu_scan(const struct shell *sh, size_t argc, char **argv)
{
	ARG_UNUSED(argc);
	ARG_UNUSED(argv);

	shell_print(sh, "Scanning I2C bus (GPIO1.0/GPIO1.1)...");

	if (!imu_powered) {
		shell_print(sh, "Note: IMU not powered. Power on first for accurate scan.");
	}

	i2c_scan_bus();
	shell_print(sh, "Scan complete. Check logs above for results.");

	return 0;
}

/* Shell command: imu on */
static int cmd_imu_on(const struct shell *sh, size_t argc, char **argv)
{
	ARG_UNUSED(argc);
	ARG_UNUSED(argv);

	if (imu_powered) {
		shell_print(sh, "IMU already powered on");
		return 0;
	}

	int ret = imu_power_on();

	if (ret == 0) {
		shell_print(sh, "IMU powered on (GPIO0.%d=HIGH)", IMU_PWR_GPIO);
	} else {
		shell_print(sh, "Error: Failed to power on IMU (%d)", ret);
	}

	return ret;
}

/* Shell command: imu off */
static int cmd_imu_off(const struct shell *sh, size_t argc, char **argv)
{
	ARG_UNUSED(argc);
	ARG_UNUSED(argv);

	if (!imu_powered) {
		shell_print(sh, "IMU already powered off");
		return 0;
	}

	int ret = imu_power_off();

	if (ret == 0) {
		shell_print(sh, "IMU powered off (GPIO0.%d=LOW)", IMU_PWR_GPIO);
	} else {
		shell_print(sh, "Error: Failed to power off IMU (%d)", ret);
	}

	return ret;
}

/* Shell command table */
SHELL_STATIC_SUBCMD_SET_CREATE(sub_imu,
	SHELL_CMD(on, NULL, "Power on IMU", cmd_imu_on),
	SHELL_CMD(off, NULL, "Power off IMU", cmd_imu_off),
	SHELL_CMD(init, NULL, "Initialize IMU (power on and configure)", cmd_imu_init),
	SHELL_CMD(scan, NULL, "Scan I2C bus for devices", cmd_imu_scan),
	SHELL_CMD(read, NULL, "Read sensor data", cmd_imu_read),
	SHELL_CMD_ARG(monitor, NULL, "Monitor sensor data [iterations]", cmd_imu_monitor, 0, 1),
	SHELL_CMD(selftest, NULL, "Run self-test", cmd_imu_selftest),
	SHELL_SUBCMD_SET_END
);

/* Root command: imu */
SHELL_CMD_REGISTER(imu, &sub_imu, "IMU (LSM6DS3) commands via software I2C", NULL);
```

## src/mic.c
```c
/*
 * Microphone module with WAV recording to SD card
 *
 * Commands:
 *   mic capture [time_sec]     - Capture and print sample stats
 *   mic record [time_sec]      - Record WAV file to SD card
 *   mic power on/off           - Control mic power
 */

#include <zephyr/kernel.h>
#include <zephyr/device.h>
#include <zephyr/drivers/gpio.h>
#include <zephyr/audio/dmic.h>
#include <zephyr/fs/fs.h>
#include <zephyr/shell/shell.h>
#include <zephyr/sys/util.h>
#include <zephyr/logging/log.h>
#include <stdio.h>
#include <stdlib.h>
#include <string.h>
#include "mic.h"
#include "sdcard.h"

LOG_MODULE_REGISTER(mic, LOG_LEVEL_INF);

#define SAMPLE_RATE_HZ 16000
#define SAMPLE_BITS 16
#define CHANNEL_COUNT 2
#define TIMEOUT_MS 500
#define CAPTURE_MS 100
#define BLOCK_SIZE (((SAMPLE_BITS / 8) * (SAMPLE_RATE_HZ * CAPTURE_MS)) / 1000) * CHANNEL_COUNT
#define BLOCK_COUNT 4

static const struct device *const dmic = DEVICE_DT_GET(DT_ALIAS(dmic0));
static const struct gpio_dt_spec mic_en = GPIO_DT_SPEC_GET_OR(DT_NODELABEL(mic_reg), gpios, {0});

K_MEM_SLAB_DEFINE_STATIC(mem_slab, BLOCK_SIZE, BLOCK_COUNT, 4);

static struct pcm_stream_cfg stream = {
	.pcm_rate = SAMPLE_RATE_HZ,
	.pcm_width = SAMPLE_BITS,
	.block_size = BLOCK_SIZE,
	.mem_slab = &mem_slab,
};

static struct dmic_cfg cfg = {
	.io =
		{
			.min_pdm_clk_freq = 1000000,
			.max_pdm_clk_freq = 3500000,
			.min_pdm_clk_dc = 40,
			.max_pdm_clk_dc = 60,
		},
	.streams = &stream,
	.channel =
		{
			.req_num_streams = 1,
			.req_num_chan = CHANNEL_COUNT,
		},
};

static bool initialized;
static uint16_t recording_counter;

/* WAV file header (44 bytes) */
struct wav_header {
	uint8_t  riff[4];         /* "RIFF" */
	uint32_t file_size;       /* File size - 8 */
	uint8_t  wave[4];         /* "WAVE" */
	uint8_t  fmt[4];         /* "fmt " */
	uint32_t fmt_size;       /* 16 for PCM */
	uint16_t audio_format;   /* 1 = PCM */
	uint16_t num_channels;
	uint32_t sample_rate;
	uint32_t byte_rate;      /* sample_rate * num_channels * bits_per_sample/8 */
	uint16_t block_align;    /* num_channels * bits_per_sample/8 */
	uint16_t bits_per_sample;
	uint8_t  data[4];        /* "data" */
	uint32_t data_size;      /* num_samples * num_channels * bits_per_sample/8 */
};

static void wav_header_init(struct wav_header *hdr, uint16_t channels,
			    uint32_t sample_rate, uint16_t bits_per_sample,
			    uint32_t data_size)
{
	memcpy(hdr->riff, "RIFF", 4);
	memcpy(hdr->wave, "WAVE", 4);
	memcpy(hdr->fmt, "fmt ", 4);
	memcpy(hdr->data, "data", 4);

	hdr->fmt_size = 16;
	hdr->audio_format = 1;
	hdr->num_channels = channels;
	hdr->sample_rate = sample_rate;
	hdr->bits_per_sample = bits_per_sample;
	hdr->block_align = channels * bits_per_sample / 8;
	hdr->byte_rate = sample_rate * hdr->block_align;
	hdr->data_size = data_size;
	hdr->file_size = data_size + 36;
}

static void wav_header_write(struct fs_file_t *file, uint16_t channels,
			     uint32_t sample_rate, uint16_t bits_per_sample,
			     uint32_t data_size)
{
	struct wav_header hdr;

	wav_header_init(&hdr, channels, sample_rate, bits_per_sample, data_size);
	fs_seek(file, 0, SEEK_SET);
	fs_write(file, &hdr, sizeof(hdr));
}

/* Record WAV file to SD card */
static int cmd_mic_record(const struct shell *sh, size_t argc, char **argv)
{
	int ret, time = 3;
	char filepath[64];
	struct fs_file_t file;
	uint32_t total_data_size = 0;
	uint32_t start_time, end_time;

	if (argc > 1) {
		time = strtol(argv[1], NULL, 10);
		if (time <= 0 || time > 300) {
			shell_error(sh, "Invalid time (1-300 seconds)");
			return -EINVAL;
		}
	}

	if (!initialized) {
		shell_error(sh, "Microphone not initialized");
		return -EPERM;
	}

	if (!sdcard_is_mounted()) {
		shell_error(sh, "SD card not mounted. Use 'sd mount' first");
		return -ENODEV;
	}

	/* Generate filename */
	recording_counter++;
	snprintf(filepath, sizeof(filepath), "/SD:/REC%04u.WAV", recording_counter);

	shell_print(sh, "Recording %d sec to %s ...", time, filepath);

	/* Create file and write placeholder header */
	fs_file_t_init(&file);
	ret = fs_open(&file, filepath, FS_O_CREATE | FS_O_WRITE);
	if (ret != 0) {
		shell_error(sh, "Failed to create file: %d", ret);
		return ret;
	}

	/* Write placeholder header (will be updated at end) */
	struct wav_header hdr;
	wav_header_init(&hdr, CHANNEL_COUNT, SAMPLE_RATE_HZ, SAMPLE_BITS, 0);
	fs_write(&file, &hdr, sizeof(hdr));

	/* Power on mic */
	mic_power_on();

	ret = dmic_configure(dmic, &cfg);
	if (ret < 0) {
		shell_error(sh, "DMIC configure failed: %d", ret);
		fs_close(&file);
		mic_power_off();
		return ret;
	}

	start_time = (uint32_t)k_uptime_get_32();
	int blocks_target = time * (1000 / CAPTURE_MS);

	for (int i = 0; i < blocks_target; i++) {
		void *buffer = NULL;
		uint32_t size;

		ret = dmic_trigger(dmic, DMIC_TRIGGER_START);
		if (ret < 0) {
			shell_error(sh, "START failed: %d", ret);
			break;
		}

		ret = dmic_read(dmic, 0, &buffer, &size, TIMEOUT_MS);
		if (ret < 0) {
			dmic_trigger(dmic, DMIC_TRIGGER_STOP);
			break;
		}

		/* Write PCM data to file */
		fs_write(&file, buffer, size);
		total_data_size += size;

		k_mem_slab_free(&mem_slab, buffer);
		dmic_trigger(dmic, DMIC_TRIGGER_STOP);

		/* Progress every second */
		if ((i + 1) % (1000 / CAPTURE_MS) == 0) {
			uint32_t elapsed = ((uint32_t)k_uptime_get_32() - start_time) / 1000;
			shell_print(sh, "  %u/%u sec (%u KB)",
				    elapsed, (uint32_t)time,
				    total_data_size / 1024);
		}
	}

	end_time = (uint32_t)k_uptime_get_32();

	/* Update WAV header with actual data size */
	wav_header_write(&file, CHANNEL_COUNT, SAMPLE_RATE_HZ, SAMPLE_BITS, total_data_size);
	fs_close(&file);

	mic_power_off();

	uint32_t elapsed_ms = end_time - start_time;
	uint32_t file_kb = (total_data_size + sizeof(hdr)) / 1024;

	shell_print(sh, "Recording complete:");
	shell_print(sh, "  File: %s (%u KB)", filepath, file_kb);
	shell_print(sh, "  Duration: %u ms", elapsed_ms);
	shell_print(sh, "  Channels: %d, Rate: %d Hz, Bits: %d",
		    CHANNEL_COUNT, SAMPLE_RATE_HZ, SAMPLE_BITS);
	shell_print(sh, "  Use 'usb msc on' to access via USB");

	return 0;
}

/* Capture and print sample stats (original behavior) */
static int cmd_mic_capture(const struct shell *sh, size_t argc, char **argv)
{
	int ret, time = 1;
	void *buffer = NULL;
	uint32_t size;

	if (argc > 1) {
		char *endptr;
		time = strtol(argv[1], &endptr, 10);
		if (*endptr != '\0' || time <= 0) {
			shell_error(sh, "Invalid time argument");
			return -EINVAL;
		}
		time *= (1000 / CAPTURE_MS);
	}

	if (!initialized) {
		shell_error(sh, "Microphone not initialized");
		return -EPERM;
	}

	mic_power_on();

	shell_print(sh, "S");
	ret = dmic_configure(dmic, &cfg);
	if (ret < 0) {
		shell_error(sh, "Failed to configure DMIC(%d)", ret);
		goto cleanup;
	}

	for (int i = 0; i < time; i++) {
		ret = dmic_trigger(dmic, DMIC_TRIGGER_START);
		if (ret < 0) {
			shell_error(sh, "START trigger failed (%d)", ret);
			goto cleanup;
		}

		ret = dmic_read(dmic, 0, &buffer, &size, TIMEOUT_MS);
		if (ret < 0) {
			shell_error(sh, "DMIC read failed (%d)", ret);
			dmic_trigger(dmic, DMIC_TRIGGER_STOP);
			goto cleanup;
		}

		int16_t *samples = (int16_t *)buffer;
		uint32_t num_samples = size / sizeof(int16_t);
		int32_t sum = 0;
		int16_t min = 0, max = 0;

		for (uint32_t j = 0; j < num_samples; j++) {
			sum += samples[j];
			if (j == 0 || samples[j] < min) min = samples[j];
			if (j == 0 || samples[j] > max) max = samples[j];
		}

		int32_t avg = sum / num_samples;
		shell_print(sh, "Block %u: samples=%u, avg=%d, min=%d, max=%d",
			    i + 1, num_samples, avg, min, max);

		k_mem_slab_free(&mem_slab, buffer);
		buffer = NULL;
		ret = dmic_trigger(dmic, DMIC_TRIGGER_STOP);
		if (ret < 0) {
			shell_error(sh, "STOP trigger failed (%d)", ret);
		}
	}

cleanup:
	if (buffer) {
		k_mem_slab_free(&mem_slab, buffer);
	}
	shell_print(sh, "E");
	mic_power_off();

	return ret;
}

SHELL_STATIC_SUBCMD_SET_CREATE(sub_mic_cmds,
	SHELL_CMD_ARG(capture, NULL, "Capture mic data [time_sec]", cmd_mic_capture, 0, 1),
	SHELL_CMD_ARG(record, NULL, "Record WAV to SD card [time_sec]", cmd_mic_record, 0, 1),
	SHELL_SUBCMD_SET_END
);

SHELL_CMD_REGISTER(mic, &sub_mic_cmds, "Microphone commands", NULL);

int mic_power_off(void)
{
	if (mic_en.port) {
		gpio_pin_configure_dt(&mic_en, GPIO_OUTPUT);
		gpio_pin_set_dt(&mic_en, 0);
	}
	return 0;
}

int mic_power_on(void)
{
	if (mic_en.port) {
		gpio_pin_configure_dt(&mic_en, GPIO_OUTPUT);
		gpio_pin_set_dt(&mic_en, 1);
	}
	return 0;
}

int mic_init(void)
{
	if (!device_is_ready(dmic)) {
		return -ENODEV;
	}

	mic_power_off();

	cfg.channel.req_chan_map_lo =
		dmic_build_channel_map(0, 0, PDM_CHAN_LEFT) |
		dmic_build_channel_map(1, 0, PDM_CHAN_RIGHT);

	initialized = true;

	return 0;
}
```

## src/oled.h
```c
/*
 * Copyright (c) 2023 Nordic Semiconductor ASA
 *
 * SPDX-License-Identifier: LicenseRef-Nordic-5-Clause
 */

#ifndef OLED_H
#define OLED_H

#include <zephyr/kernel.h>

/**
 * @brief Initialize OLED display
 * @return 0 on success, negative errno on failure
 */
int oled_init(void);

/**
 * @brief Show battery status on the OLED (discharge/charge cycle test)
 *
 * Renders four lines: "Bat: NN%", the charge/discharge state with the cycle
 * count (e.g. "DISCHARGE #5"), the battery voltage in mV, and the battery
 * temperature.
 *
 * @param pct Battery percentage (0-100)
 * @param charging True if charging
 * @param mv Battery voltage in millivolts
 * @param temp_c Battery temperature in degrees Celsius
 * @param state State string, e.g. "CHARGE" / "DISCHARGE"
 * @param cycles Completed charge/discharge cycle count
 */
void oled_show_battery(uint8_t pct, bool charging, uint32_t mv, int32_t temp_c,
		       const char *state, uint32_t cycles);

/**
 * @brief Test 1: Clear display
 */
void oled_test_clear(void);

/**
 * @brief Test 2: Fill display
 */
void oled_test_fill(void);

/**
 * @brief Test 3: Display test pattern
 */
void oled_test_pattern(void);

/**
 * @brief Test 4: Circle animation (breathing effect)
 */
void oled_test_circle_anim(void);

/**
 * @brief Test 5: Pixel manipulation test (checkerboard)
 */
void oled_test_pixels(void);

/**
 * @brief Run all OLED tests sequentially
 */
void oled_run_all_tests(void);

#endif /* OLED_H */
```

## src/pmic.h
```c
/*
 * Copyright (c) 2023 Nordic Semiconductor ASA
 *
 * SPDX-License-Identifier: LicenseRef-Nordic-5-Clause
 */

#ifndef PMIC_H
#define PMIC_H

#include <zephyr/kernel.h>

/**
 * @brief Initialize PMIC (NPM1300)
 * @return 0 on success, negative errno on failure
 */
int pmic_init(void);

/**
 * @brief Get battery status
 * @param voltage_mv Pointer to store voltage in mV
 * @param percent Pointer to store battery percentage
 * @param charging Pointer to store charging state
 * @param temp_c Pointer to store battery temperature (degrees C, NTC)
 * @return 0 on success, negative errno on failure
 */
int pmic_get_battery_status(uint32_t *voltage_mv, uint8_t *percent, bool *charging,
			    int32_t *temp_c);

/**
 * @brief Enable or disable battery charging at runtime
 *
 * Disabling makes the device run on battery (used to force a discharge).
 * Re-enabling resumes charging if VBUS is present.
 *
 * @param enable true to charge, false to stop charging
 * @return 0 on success, negative errno on failure
 */
int pmic_charger_set(bool enable);

/**
 * @brief Check whether the charger reports charge-complete
 * @return true if the NPM1300 reports the COMPLETE status bit
 */
bool pmic_is_charge_complete(void);

/**
 * @brief Enter ship mode (power off)
 * @return 0 on success, negative errno on failure
 */
int pmic_enter_ship_mode(void);

#endif /* PMIC_H */
```

## src/re_test.c
```c
/*
 * Copyright (c) 2026 Seeed Technology Co., Ltd.
 *
 * SPDX-License-Identifier: LicenseRef-Nordic-5-Clause
 */

#include <zephyr/kernel.h>
#include <zephyr/device.h>
#include <zephyr/drivers/flash.h>
#include <zephyr/audio/dmic.h>
#include <zephyr/fs/fs.h>
#include <zephyr/logging/log.h>
#include <string.h>

#include "re_test.h"
#include "sdcard.h"
#include "oled.h"
#include "motor.h"
#include "pmic.h"
#include "mic.h"
#include "wifi.h"
#include "ble.h"

LOG_MODULE_REGISTER(re_test, LOG_LEVEL_INF);

#define NUM_TESTS 8
#define FLASH_TEST_OFFSET 0x130000

#define MIC_SAMPLE_RATE 16000
#define MIC_SAMPLE_BITS 16
#define MIC_CHANNELS 2
#define MIC_CAPTURE_MS 100
#define MIC_BLOCK_SIZE (((MIC_SAMPLE_BITS / 8) * (MIC_SAMPLE_RATE * MIC_CAPTURE_MS)) / 1000) * MIC_CHANNELS
#define MIC_BLOCK_COUNT 4

K_MEM_SLAB_DEFINE_STATIC(re_mic_slab, MIC_BLOCK_SIZE, MIC_BLOCK_COUNT, 4);

static struct re_test_stats stats[NUM_TESTS] = {
	{ "SD Card",  0, 0 },
	{ "Flash",    0, 0 },
	{ "OLED",     0, 0 },
	{ "Motor",    0, 0 },
	{ "PMIC",     0, 0 },
	{ "MIC",      0, 0 },
	{ "WiFi AP",  0, 0 },
	{ "BLE",      0, 0 },
};

static uint32_t round_count;
static volatile bool stop_requested;

typedef int (*re_test_fn)(void);

/* --- Test wrappers --- */

static int test_sd(void)
{
	int rc;

	if (!sdcard_is_mounted()) {
		rc = sdcard_mount();
		if (rc != 0) {
			return rc;
		}
	}

	struct fs_file_t file;
	char write_buf[256];
	char read_buf[256];

	for (int i = 0; i < sizeof(write_buf); i++) {
		write_buf[i] = (char)(i & 0xFF);
	}

	fs_file_t_init(&file);
	rc = fs_open(&file, "/SD:/re_test.tmp", FS_O_CREATE | FS_O_WRITE | FS_O_RDWR);
	if (rc != 0) {
		return rc;
	}

	rc = fs_write(&file, write_buf, sizeof(write_buf));
	fs_close(&file);
	if (rc < 0) {
		return rc;
	}

	fs_file_t_init(&file);
	rc = fs_open(&file, "/SD:/re_test.tmp", FS_O_READ);
	if (rc != 0) {
		return rc;
	}

	rc = fs_read(&file, read_buf, sizeof(read_buf));
	fs_close(&file);

	fs_unlink("/SD:/re_test.tmp");

	if (rc < 0) {
		return rc;
	}

	if (memcmp(write_buf, read_buf, sizeof(write_buf)) != 0) {
		return -EIO;
	}

	return 0;
}

static int test_flash(void)
{
	const struct device *flash_dev;
	uint8_t write_buf[256];
	uint8_t read_buf[256];
	int rc;

	flash_dev = DEVICE_DT_GET(DT_NODELABEL(spi_flash));
	if (!device_is_ready(flash_dev)) {
		return -ENODEV;
	}

	for (int i = 0; i < sizeof(write_buf); i++) {
		write_buf[i] = (uint8_t)(i ^ 0xAA);
	}

	rc = flash_erase(flash_dev, FLASH_TEST_OFFSET, 4096);
	if (rc != 0) {
		return rc;
	}

	rc = flash_write(flash_dev, FLASH_TEST_OFFSET, write_buf, sizeof(write_buf));
	if (rc != 0) {
		return rc;
	}

	rc = flash_read(flash_dev, FLASH_TEST_OFFSET, read_buf, sizeof(read_buf));
	if (rc != 0) {
		return rc;
	}

	if (memcmp(write_buf, read_buf, sizeof(write_buf)) != 0) {
		return -EIO;
	}

	return 0;
}

static int test_oled(void)
{
	oled_run_all_tests();
	return 0;
}

static int test_motor(void)
{
	int rc = motor_set(true);
	if (rc != 0) {
		return rc;
	}
	k_msleep(100);
	rc = motor_set(false);
	return rc;
}

static int test_pmic(void)
{
	uint32_t voltage_mv;
	uint8_t percent;
	bool charging;
	int32_t temp;

	int rc = pmic_get_battery_status(&voltage_mv, &percent, &charging, &temp);
	if (rc != 0) {
		return rc;
	}

	if (voltage_mv == 0) {
		return -EIO;
	}

	LOG_INF("  PMIC: %u mV, %u%%, %s, %dC", voltage_mv, percent,
		charging ? "charging" : "discharging", temp);
	return 0;
}

static int test_mic(void)
{
	const struct device *dmic_dev;
	void *buffer = NULL;
	uint32_t size;
	int ret;

	dmic_dev = DEVICE_DT_GET(DT_ALIAS(dmic0));
	if (!device_is_ready(dmic_dev)) {
		return -ENODEV;
	}

	mic_power_on();

	struct pcm_stream_cfg stream = {
		.pcm_rate = MIC_SAMPLE_RATE,
		.pcm_width = MIC_SAMPLE_BITS,
		.block_size = MIC_BLOCK_SIZE,
		.mem_slab = &re_mic_slab,
	};
	struct dmic_cfg cfg = {
		.io = {
			.min_pdm_clk_freq = 1000000,
			.max_pdm_clk_freq = 3500000,
			.min_pdm_clk_dc = 40,
			.max_pdm_clk_dc = 60,
		},
		.streams = &stream,
		.channel = {
			.req_num_streams = 1,
			.req_num_chan = MIC_CHANNELS,
			.req_chan_map_lo =
				dmic_build_channel_map(0, 0, PDM_CHAN_LEFT) |
				dmic_build_channel_map(1, 0, PDM_CHAN_RIGHT),
		},
	};

	ret = dmic_configure(dmic_dev, &cfg);
	if (ret < 0) {
		goto cleanup;
	}

	ret = dmic_trigger(dmic_dev, DMIC_TRIGGER_START);
	if (ret < 0) {
		goto cleanup;
	}

	ret = dmic_read(dmic_dev, 0, &buffer, &size, 2000);
	dmic_trigger(dmic_dev, DMIC_TRIGGER_STOP);

	if (ret < 0 || buffer == NULL) {
		ret = ret < 0 ? ret : -EIO;
		goto cleanup;
	}

	/* Check for non-zero samples */
	int16_t *samples = (int16_t *)buffer;
	uint32_t num_samples = size / sizeof(int16_t);
	int32_t sum = 0;
	for (uint32_t i = 0; i < num_samples; i++) {
		sum += (int32_t)samples[i] > 0 ? samples[i] : -samples[i];
	}

	if (sum == 0) {
		ret = -EIO;
	}

	LOG_INF("  MIC: %u samples, avg_abs=%d", num_samples,
		num_samples > 0 ? (int)(sum / num_samples) : 0);

cleanup:
	if (buffer) {
		k_mem_slab_free(&re_mic_slab, buffer);
	}
	mic_power_off();
	return ret;
}

static int test_wifi(void)
{
	if (wifi_ap_is_running()) {
		return 0;
	}
	return -EIO;
}

static int test_ble(void)
{
	return 0;
}

static re_test_fn test_fns[NUM_TESTS] = {
	test_sd,
	test_flash,
	test_oled,
	test_motor,
	test_pmic,
	test_mic,
	test_wifi,
	test_ble,
};

/* --- OLED status display --- */

static void oled_show_status(int test_idx, bool pass)
{
	oled_test_clear();
	if (pass) {
		oled_test_pattern();
	} else {
		oled_test_fill();
	}
}

/* --- Summary print --- */

static void print_summary(void)
{
	uint32_t total_pass = 0, total_fail = 0;

	printk("\n=== RE Test Round #%u ===\n", round_count);
	for (int i = 0; i < NUM_TESTS; i++) {
		printk("  %-10s: %s\n", stats[i].name,
		       (stats[i].fail > 0 && stats[i].pass == 0) ? "FAIL" : "PASS");

		total_pass += stats[i].pass;
		total_fail += stats[i].fail;
	}

	printk("--- Round #%u done ---\n", round_count);
	printk("Running totals: %u pass, %u fail, %u rounds\n\n",
	       total_pass, total_fail, round_count);
}

/* --- Main test loop --- */

void re_test_request_stop(void)
{
	stop_requested = true;
}

void re_test_loop(void)
{
	printk("\n====== RE Test Starting ======\n");
	printk("Testing %d peripherals in infinite loop\n\n", NUM_TESTS);

	while (!stop_requested) {
		round_count++;

		for (int i = 0; i < NUM_TESTS && !stop_requested; i++) {
			int rc = test_fns[i]();

			if (rc == 0) {
				stats[i].pass++;
				LOG_INF("[%s] PASS", stats[i].name);
			} else {
				stats[i].fail++;
				LOG_INF("[%s] FAIL (err=%d)", stats[i].name, rc);
			}

			oled_show_status(i, rc == 0);
			k_sleep(K_MSEC(500));
		}

		print_summary();
		oled_test_clear();
	}
}
```

## src/re_test.h
```c
/*
 * Copyright (c) 2026 Seeed Technology Co., Ltd.
 *
 * SPDX-License-Identifier: LicenseRef-Nordic-5-Clause
 */

#ifndef RE_TEST_H
#define RE_TEST_H

#include <zephyr/kernel.h>

struct re_test_stats {
	const char *name;
	uint32_t pass;
	uint32_t fail;
};

void re_test_loop(void);
void re_test_request_stop(void);

#endif /* RE_TEST_H */
```

## src/sdcard.h
```c
/*
 * Copyright (c) 2023 Nordic Semiconductor ASA
 *
 * SPDX-License-Identifier: LicenseRef-Nordic-5-Clause
 */

#ifndef SDCARD_H_
#define SDCARD_H_

/**
 * @brief Initialize SD card and register shell commands
 * Shell commands:
 *   sd mount  - Mount SD card
 *   sd umount - Unmount SD card
 *   sd status - Show SD card status
 *
 * @return 0 on success, negative error code on failure
 */
int sdcard_init(void);

bool sdcard_is_mounted(void);
int sdcard_mount(void);
int sdcard_unmount(void);

/**
 * @brief Enable/disable the continuous SD-read discharge load
 *
 * On first enable, writes a fixed 1 MB read file ONCE (then pure read, no NAND
 * wear). A background thread reads it in a loop while enabled, adding ~15-25 mA
 * (card read + SPI4 + CPU) on top of the WiFi TX load for faster discharge.
 * @param enable true to run the read load (discharge), false to idle (charge)
 * @return 0
 */
int sdcard_discharge_load_enable(bool enable);

#endif /* SDCARD_H_ */
```
