## CMakeLists.txt
```
#
# Copyright (c) 2026 Seeed Technology Co., Ltd.
#
# SPDX-License-Identifier: LicenseRef-Nordic-5-Clause
#

cmake_minimum_required(VERSION 3.20.0)

find_package(Zephyr REQUIRED HINTS $ENV{ZEPHYR_BASE})
project(re_test)

target_sources(app PRIVATE
	src/main.c
	src/re_test.c
	src/ble.c
	src/wifi.c
	src/button.c
	src/sdcard.c
	src/mic.c
	src/oled.c
	src/pmic.c
	src/motor.c
	src/imu.c
	src/flash_test.c
)
```

## sysbuild.conf
```
# Test/factory firmware — flashed directly via J-Link, no MCUboot bootloader.
SB_CONFIG_BOOTLOADER_NONE=y
SB_CONFIG_SECURE_BOOT_NETCORE=n
# Disable the Partition Manager so this no-mcuboot image links at 0x0 instead of
# inheriting the board pm_static (which reserves 0x0 for mcuboot -> app@0x16200,
# 0x0 empty -> no boot).
SB_CONFIG_PARTITION_MANAGER=n
```

## prj.conf
```kconfig
#
# Copyright (c) 2023 Nordic Semiconductor ASA
#
# SPDX-License-Identifier: LicenseRef-Nordic-5-Clause
#

# DMIC (Digital Microphone)
CONFIG_AUDIO=y
CONFIG_AUDIO_DMIC=y

# GPIO button input driver
CONFIG_INPUT=y
CONFIG_INPUT_GPIO_BUTTON_OWN_THREAD=y
CONFIG_INPUT_GPIO_BUTTON_THREAD_STACK_SIZE=1024
CONFIG_GPIO_BUTTON=y

# SD Card and File System
CONFIG_DISK_ACCESS=y
CONFIG_DISK_DRIVER_SDMMC=y
CONFIG_FILE_SYSTEM=y
CONFIG_FAT_FILESYSTEM_ELM=y
CONFIG_FS_FATFS_LFN=y
CONFIG_FS_FATFS_MKFS=y
CONFIG_FILE_SYSTEM_MKFS=y

# SPI Flash
CONFIG_FLASH=y
CONFIG_FLASH_MAP=y

# WiFi AP mode
CONFIG_WIFI=y
CONFIG_WIFI_NRF70=y
CONFIG_NRF70_AP_MODE=y
CONFIG_WIFI_NM_WPA_SUPPLICANT=y
CONFIG_WIFI_NM_WPA_SUPPLICANT_AP=y
CONFIG_WIFI_NM_WPA_SUPPLICANT_LOG_LEVEL_INF=n
CONFIG_WIFI_RANDOM_MAC_ADDRESS=y

# WiFi and BLE coexistence
CONFIG_NRF70_SR_COEX=y
CONFIG_WIFI_READY_LIB=y
CONFIG_NRF_WIFI_IF_AUTO_START=n

# Reduce memory usage - fewer buffers
CONFIG_NRF70_RX_NUM_BUFS=8
CONFIG_NRF70_MAX_TX_AGGREGATION=2

# Disable RPU power save
CONFIG_NRF70_RPU_PS_IDLE_TIMEOUT_MS=3600000

# WiFi credentials - not needed for AP mode
CONFIG_WIFI_CREDENTIALS=n

# Disable WPA3/SAE - WPA2-PSK only
CONFIG_WIFI_NM_WPA_SUPPLICANT_WPA3=n
CONFIG_WIFI_NM_WPA_SUPPLICANT_11AX=n
CONFIG_WIFI_NM_WPA_SUPPLICANT_11AC=n

# WiFi memory
CONFIG_NRF_WIFI_CTRL_HEAP_SIZE=20000
CONFIG_NRF_WIFI_DATA_HEAP_SIZE=53000
CONFIG_WIFI_NM_WPA_SUPPLICANT_THREAD_STACK_SIZE=10240

# zperf for throughput testing
CONFIG_NET_ZPERF=y

# Networking Management API
CONFIG_NET_MGMT=y
CONFIG_NET_MGMT_EVENT=y

# AP static IP
CONFIG_NET_CONFIG_SETTINGS=y
CONFIG_NET_CONFIG_INIT_TIMEOUT=0
CONFIG_NET_CONFIG_MY_IPV4_ADDR="192.168.4.1"
CONFIG_NET_CONFIG_MY_IPV4_NETMASK="255.255.255.0"
CONFIG_NET_CONFIG_MY_IPV4_GW="192.168.4.1"

# DHCP server for AP clients
CONFIG_NET_DHCPV4=y
CONFIG_NET_DHCPV4_SERVER=y
CONFIG_NET_DHCPV4_SERVER_ADDR_COUNT=1

# Shell - minimal
CONFIG_SHELL=y
CONFIG_SHELL_BACKEND_SERIAL=y
CONFIG_NET_SHELL=n
CONFIG_WIFI_CREDENTIALS_SHELL=n
CONFIG_NET_L2_WIFI_SHELL=n

# Filesystem shell commands
CONFIG_FILE_SYSTEM_SHELL=y

# Flash and Regulator shell commands
CONFIG_FLASH_SHELL=y
CONFIG_REGULATOR=y
CONFIG_REGULATOR_SHELL=y
CONFIG_GPIO_SHELL=y

# Sensor (for PMIC battery/charger monitoring)
CONFIG_SENSOR=y


# I2C and I2C shell commands
CONFIG_I2C=y
CONFIG_I2C_SHELL=y

# Shell stack size - increased for WiFi operations
CONFIG_SHELL_STACK_SIZE=4096

# Logging - minimal, use thread mode to reduce impact
CONFIG_LOG=y
CONFIG_LOG_DEFAULT_LEVEL=3
CONFIG_LOG_BACKEND_UART=y
CONFIG_LOG_BACKEND_RTT=n
# CONFIG_LOG_MODE_IMMEDIATE is not set - use threaded mode

# System settings
CONFIG_NEWLIB_LIBC=y
CONFIG_NEWLIB_LIBC_NANO=n

# Minimal networking - UDP only
CONFIG_NETWORKING=y
CONFIG_NET_SOCKETS=y
CONFIG_NET_SOCKETS_POLL_MAX=4
CONFIG_NET_L2_ETHERNET=y
CONFIG_NET_L2_WIFI_MGMT=y
CONFIG_NET_IPV4=y
CONFIG_NET_IPV6=n
CONFIG_NET_UDP=y
CONFIG_NET_TCP=n

# mbedTLS - use nRF security library instead of builtin
CONFIG_MBEDTLS=y
CONFIG_MBEDTLS_LEGACY_CRYPTO_C=n

# Memory optimization - reduced for RAM efficiency
CONFIG_SYSTEM_WORKQUEUE_STACK_SIZE=6144
CONFIG_MAIN_STACK_SIZE=6144

# Heap size for WiFi/crypto operations
CONFIG_HEAP_MEM_POOL_SIZE=120000

CONFIG_MBEDTLS_HEAP_SIZE=1024

# Network buffers (balanced for stability)
CONFIG_NET_TC_TX_COUNT=2
CONFIG_NET_BUF_TX_COUNT=14
CONFIG_NET_BUF_RX_COUNT=14
CONFIG_NET_PKT_TX_COUNT=6
CONFIG_NET_PKT_RX_COUNT=6
CONFIG_NET_TX_STACK_SIZE=4096
CONFIG_NET_RX_STACK_SIZE=4096

CONFIG_NET_BUF_FIXED_DATA_SIZE=y
CONFIG_NET_BUF_DATA_SIZE=512

# DHCP
CONFIG_NET_DHCPV4=y

CONFIG_WIFI_RANDOM_MAC_ADDRESS=y
CONFIG_BT=y
CONFIG_BT_PERIPHERAL=y
CONFIG_BT_DEVICE_NAME="Clip_Test"
CONFIG_BT_MAX_CONN=1
CONFIG_BT_SMP=y
CONFIG_BT_SIGNING=y
CONFIG_BT_GATT_CLIENT=y

# BLE throughput optimization
CONFIG_BT_BUF_ACL_RX_SIZE=251
CONFIG_BT_BUF_ACL_TX_SIZE=251
CONFIG_BT_L2CAP_TX_MTU=247
CONFIG_BT_CTLR_DATA_LENGTH_MAX=251

# Increase thread priority for BLE operations
CONFIG_BT_RX_STACK_SIZE=2048

# Display support (OLED CH1115)
CONFIG_DISPLAY=y
CONFIG_GPIO=y

# USB Mass Storage (expose SD card as USB drive)
CONFIG_USB_DEVICE_STACK_NEXT=y
CONFIG_USBD_MSC_CLASS=y
CONFIG_USBD_MSC_LUNS_PER_INSTANCE=1
CONFIG_USBD_MSC_DOUBLE_BUFFERING=n
CONFIG_USBD_MSC_SCSI_BUFFER_SIZE=512
CONFIG_HWINFO=y

# Reboot command
CONFIG_REBOOT=y
```

## src/main.c
```c
/*
 * Copyright (c) 2026 Seeed Technology Co., Ltd.
 *
 * SPDX-License-Identifier: LicenseRef-Nordic-5-Clause
 */

#include <zephyr/kernel.h>
#include <zephyr/logging/log.h>

#include "button.h"
#include "sdcard.h"
#include "oled.h"
#include "pmic.h"
#include "motor.h"
#include "mic.h"
#include "wifi.h"
#include "ble.h"
#include "re_test.h"

LOG_MODULE_REGISTER(main, LOG_LEVEL_INF);

int main(void)
{
	int ret;

	printk("=== RE Test Firmware ===\n");
	printk("Auto peripheral reliability test\n\n");

	/* Initialize peripherals */
	ret = button_init();
	if (ret != 0) {
		LOG_WRN("Button init failed: %d", ret);
	}

	ret = sdcard_init();
	if (ret != 0) {
		LOG_WRN("SD card init failed: %d", ret);
	}

	ret = mic_init();
	if (ret != 0) {
		LOG_WRN("MIC init failed: %d", ret);
	}

	ret = oled_init();
	if (ret != 0) {
		LOG_WRN("OLED init failed: %d", ret);
	}

	ret = pmic_init();
	if (ret != 0) {
		LOG_WRN("PMIC init failed: %d", ret);
	}

	ret = motor_init();
	if (ret != 0) {
		LOG_WRN("Motor init failed: %d", ret);
	}

	/* Start WiFi AP */
	ret = wifi_run_test();
	if (ret != 0) {
		LOG_WRN("WiFi init failed: %d", ret);
	}

	/* Start BLE advertising */
	ret = ble_init();
	if (ret != 0) {
		LOG_WRN("BLE init failed: %d", ret);
	}

	printk("All peripherals initialized\n");
	printk("Starting test loop...\n\n");

	/* Enter infinite test loop */
	re_test_loop();

	return 0;
}
```

## src/flash_test.c
```c
/*
 * Copyright (c) 2026 Seeed Technology Co., Ltd.
 *
 * SPDX-License-Identifier: LicenseRef-Nordic-5-Clause
 */

#include <zephyr/kernel.h>
#include <zephyr/device.h>
#include <zephyr/drivers/flash.h>
#include <zephyr/logging/log.h>
#include <zephyr/shell/shell.h>
#include <stdlib.h>
#include <string.h>

LOG_MODULE_REGISTER(flash_test, LOG_LEVEL_INF);

/* Test at LittleFS partition offset to avoid OTA slots */
#define FLASH_TEST_OFFSET 0x130000
#define FLASH_TEST_MAX_SIZE (10 * 1024 * 1024)
#define CHUNK_SIZE 4096

static int cmd_flash_speed(const struct shell *sh, size_t argc, char **argv)
{
	const struct device *flash_dev;
	uint32_t test_size = 1024 * 1024; /* 1MB default */
	uint8_t *write_buf;
	uint8_t *read_buf;
	uint64_t start_time, end_time;
	int rc;

	flash_dev = DEVICE_DT_GET(DT_NODELABEL(spi_flash));
	if (!device_is_ready(flash_dev)) {
		shell_error(sh, "SPI flash not ready");
		return -ENODEV;
	}

	if (argc >= 2) {
		test_size = atoi(argv[1]) * 1024;
		if (test_size < CHUNK_SIZE) {
			test_size = CHUNK_SIZE;
		}
		if (test_size > FLASH_TEST_MAX_SIZE) {
			test_size = FLASH_TEST_MAX_SIZE;
		}
	}

	shell_print(sh, "Flash speed test (size: %u KB, offset: 0x%x)...",
		    test_size / 1024, FLASH_TEST_OFFSET);

	write_buf = k_malloc(CHUNK_SIZE);
	read_buf = k_malloc(CHUNK_SIZE);
	if (!write_buf || !read_buf) {
		shell_error(sh, "Failed to allocate buffers");
		k_free(write_buf);
		k_free(read_buf);
		return -ENOMEM;
	}

	/* Fill write buffer with pattern */
	for (uint32_t i = 0; i < CHUNK_SIZE; i++) {
		write_buf[i] = (uint8_t)(i & 0xFF);
	}

	/* Erase test */
	shell_print(sh, "Erasing %u KB...", test_size / 1024);
	start_time = k_uptime_get();
	for (uint32_t offset = 0; offset < test_size; offset += CHUNK_SIZE) {
		rc = flash_erase(flash_dev, FLASH_TEST_OFFSET + offset, CHUNK_SIZE);
		if (rc != 0) {
			shell_error(sh, "Erase failed at 0x%x: %d",
				    FLASH_TEST_OFFSET + offset, rc);
			goto cleanup;
		}
	}
	end_time = k_uptime_get();
	{
		uint64_t erase_time = end_time - start_time;
		uint32_t erase_speed = erase_time > 0 ?
			(test_size / 1024 * 1000) / erase_time : 0;
		shell_print(sh, "Erase: %llu ms, %u KB/s", erase_time, erase_speed);
	}

	/* Write test */
	shell_print(sh, "Writing %u KB...", test_size / 1024);
	start_time = k_uptime_get();
	for (uint32_t offset = 0; offset < test_size; offset += CHUNK_SIZE) {
		rc = flash_write(flash_dev, FLASH_TEST_OFFSET + offset,
				 write_buf, CHUNK_SIZE);
		if (rc != 0) {
			shell_error(sh, "Write failed at 0x%x: %d",
				    FLASH_TEST_OFFSET + offset, rc);
			goto cleanup;
		}
	}
	end_time = k_uptime_get();
	{
		uint64_t write_time = end_time - start_time;
		uint32_t write_speed = write_time > 0 ?
			(test_size / 1024 * 1000) / write_time : 0;
		shell_print(sh, "Write: %llu ms, %u KB/s", write_time, write_speed);
	}

	/* Read test + verify */
	shell_print(sh, "Reading %u KB...", test_size / 1024);
	start_time = k_uptime_get();
	for (uint32_t offset = 0; offset < test_size; offset += CHUNK_SIZE) {
		rc = flash_read(flash_dev, FLASH_TEST_OFFSET + offset,
				read_buf, CHUNK_SIZE);
		if (rc != 0) {
			shell_error(sh, "Read failed at 0x%x: %d",
				    FLASH_TEST_OFFSET + offset, rc);
			goto cleanup;
		}
		if (memcmp(write_buf, read_buf, CHUNK_SIZE) != 0) {
			shell_error(sh, "Verify failed at 0x%x",
				    FLASH_TEST_OFFSET + offset);
		}
	}
	end_time = k_uptime_get();
	{
		uint64_t read_time = end_time - start_time;
		uint32_t read_speed = read_time > 0 ?
			(test_size / 1024 * 1000) / read_time : 0;
		shell_print(sh, "Read:  %llu ms, %u KB/s (verified)", read_time, read_speed);
	}

cleanup:
	k_free(write_buf);
	k_free(read_buf);
	return 0;
}

SHELL_STATIC_SUBCMD_SET_CREATE(sub_flash,
	SHELL_CMD_ARG(speed, NULL, "Flash speed test [size_kb]", cmd_flash_speed, 1, 1),
	SHELL_SUBCMD_SET_END
);

SHELL_CMD_REGISTER(flash, &sub_flash, "SPI flash test commands", NULL);
```

## src/pmic.c
```c
/*
 * Copyright (c) 2023 Nordic Semiconductor ASA
 *
 * SPDX-License-Identifier: LicenseRef-Nordic-5-Clause
 */

#include <stdio.h>
#include <zephyr/kernel.h>
#include <zephyr/device.h>
#include <zephyr/drivers/gpio.h>
#include <zephyr/drivers/sensor.h>
#include <zephyr/drivers/sensor/npm13xx_charger.h>
#include <zephyr/drivers/regulator.h>
#include <zephyr/shell/shell.h>
#include <zephyr/logging/log.h>
#include "pmic.h"

LOG_MODULE_REGISTER(pmic, LOG_LEVEL_INF);

/* PMIC devices */
static const struct device *charger_dev = DEVICE_DT_GET(DT_NODELABEL(npm1300_charger));
static const struct device *pmic_gpio_dev = DEVICE_DT_GET(DT_NODELABEL(npm1300_gpio));
static const struct device *pmic_regulators = DEVICE_DT_GET(DT_NODELABEL(npm1300_regulators));

/* Charger status bitmasks (BCHGCHARGESTATUS register) */
#define CHG_STATUS_COMPLETE_MASK BIT(1)
#define CHG_STATUS_TRICKLE_MASK  BIT(2)
#define CHG_STATUS_CC_MASK       BIT(3)
#define CHG_STATUS_CV_MASK       BIT(4)

/* Voltage → SoC lookup table (same as main application) */
struct volt_soc_entry {
	uint32_t mv;
	uint8_t  soc;
};

static const struct volt_soc_entry volt_soc_table[] = {
	{ 4150, 100 },
	{ 4060,  90 },
	{ 3980,  80 },
	{ 3900,  70 },
	{ 3820,  60 },
	{ 3740,  50 },
	{ 3660,  40 },
	{ 3570,  30 },
	{ 3480,  20 },
	{ 3390,  10 },
	{ 3300,   0 },
};

static uint8_t voltage_to_soc(uint32_t mv)
{
	const int n = 10;

	if (mv >= volt_soc_table[0].mv) {
		return 100;
	}
	if (mv <= volt_soc_table[n - 1].mv) {
		return 0;
	}

	for (int i = 0; i < n - 1; i++) {
		const struct volt_soc_entry *hi = &volt_soc_table[i];
		const struct volt_soc_entry *lo = &volt_soc_table[i + 1];

		if (mv <= hi->mv && mv > lo->mv) {
			uint32_t range_mv  = hi->mv - lo->mv;
			uint32_t offset_mv = mv - lo->mv;
			uint8_t  range_soc = hi->soc - lo->soc;

			return lo->soc + (uint8_t)(offset_mv * range_soc / range_mv);
		}
	}

	return 0;
}

/* Initialize PMIC */
int pmic_init(void)
{
	int ret = 0;

	LOG_INF("Initializing PMIC (NPM1300)...");

	/* Check charger device */
	if (!device_is_ready(charger_dev)) {
		LOG_WRN("npm1300 charger not ready");
		ret = -ENODEV;
	} else {
		LOG_INF("  npm1300_charger: ready");
	}

	/* Check PMIC GPIO device */
	if (!device_is_ready(pmic_gpio_dev)) {
		LOG_WRN("npm1300_gpio not ready");
		ret = -ENODEV;
	} else {
		LOG_INF("  npm1300_gpio: ready (5 GPIOs available)");
	}

	/* Check regulators device */
	if (!device_is_ready(pmic_regulators)) {
		LOG_WRN("npm1300_regulators not ready");
		ret = -ENODEV;
	} else {
		LOG_INF("  npm1300_regulators: ready");
	}

	if (ret == 0) {
		LOG_INF("PMIC initialized successfully");
	}

	return ret;
}

/* Get battery status */
int pmic_get_battery_status(uint32_t *voltage_mv, uint8_t *percent, bool *charging)
{
	struct sensor_value val;
	int ret;

	if (!device_is_ready(charger_dev)) {
		return -ENODEV;
	}

	ret = sensor_sample_fetch(charger_dev);
	if (ret < 0) {
		LOG_ERR("sensor_sample_fetch failed: %d", ret);
		return ret;
	}

	/* Get voltage */
	ret = sensor_channel_get(charger_dev, SENSOR_CHAN_GAUGE_VOLTAGE, &val);
	if (ret == 0) {
		*voltage_mv = (uint32_t)(val.val1 * 1000 + val.val2 / 1000);
		*percent = voltage_to_soc(*voltage_mv);
	} else {
		LOG_WRN("GAUGE_VOLTAGE read failed: %d", ret);
		return ret;
	}

	/* Get charging status */
	ret = sensor_channel_get(charger_dev, SENSOR_CHAN_NPM13XX_CHARGER_STATUS, &val);
	if (ret == 0) {
		int32_t status = val.val1;
		*charging = (status & (CHG_STATUS_TRICKLE_MASK |
				     CHG_STATUS_CC_MASK |
				     CHG_STATUS_CV_MASK)) != 0;
	} else {
		LOG_WRN("CHARGER_STATUS read failed: %d", ret);
	}

	return 0;
}

/* Get detailed charger status */
static int pmic_get_charger_status_string(char *buf, size_t len)
{
	struct sensor_value val;
	int ret;

	if (!device_is_ready(charger_dev)) {
		snprintf(buf, len, "Device not ready");
		return -ENODEV;
	}

	ret = sensor_sample_fetch(charger_dev);
	if (ret < 0) {
		snprintf(buf, len, "Sample fetch failed: %d", ret);
		return ret;
	}

	ret = sensor_channel_get(charger_dev, SENSOR_CHAN_NPM13XX_CHARGER_STATUS, &val);
	if (ret == 0) {
		int32_t status = val.val1;
		const char *state = "Unknown";

		if (status & CHG_STATUS_COMPLETE_MASK) {
			state = "Complete";
		} else if (status & CHG_STATUS_CV_MASK) {
			state = "CV (Constant Voltage)";
		} else if (status & CHG_STATUS_CC_MASK) {
			state = "CC (Constant Current)";
		} else if (status & CHG_STATUS_TRICKLE_MASK) {
			state = "Trickle";
		} else {
			state = "Not Charging";
		}

		snprintf(buf, len, "%s (0x%02x)", state, (unsigned int)status);
	} else {
		snprintf(buf, len, "Read failed: %d", ret);
	}

	return ret;
}

/* Enter ship mode (power off) */
int pmic_enter_ship_mode(void)
{
	if (!device_is_ready(pmic_regulators)) {
		LOG_ERR("npm1300 regulators not ready");
		return -ENODEV;
	}

	LOG_INF("Entering ship mode (power off)...");
	LOG_INF("  Wake up: hold button for ~3 seconds");

	/* Flush logs before ship mode */
	k_sleep(K_MSEC(100));

	return regulator_parent_ship_mode(pmic_regulators);
}

/* ============================================================================
 * Shell Commands
 * ============================================================================ */

/* Shell command: pmic status */
static int cmd_pmic_status(const struct shell *sh, size_t argc, char **argv)
{
	ARG_UNUSED(argc);
	ARG_UNUSED(argv);

	uint32_t voltage_mv;
	uint8_t percent;
	bool charging;
	char status_str[64];
	int ret;

	ret = pmic_get_battery_status(&voltage_mv, &percent, &charging);
	if (ret == 0) {
		shell_print(sh, "Battery Status:");
		shell_print(sh, "  Voltage: %u mV", voltage_mv);
		shell_print(sh, "  Level:   %u%%", percent);
		shell_print(sh, "  Charging: %s", charging ? "Yes" : "No");

		/* Get detailed charger status */
		pmic_get_charger_status_string(status_str, sizeof(status_str));
		shell_print(sh, "  Charger: %s", status_str);
	} else {
		shell_print(sh, "Error: Failed to read battery status (%d)", ret);
	}

	return ret;
}

/* Shell command: pmic monitor (continuous monitoring) */
static int cmd_pmic_monitor(const struct shell *sh, size_t argc, char **argv)
{
	uint32_t voltage_mv;
	uint8_t percent;
	bool charging;
	int iterations = 0;
	int max_iter = 10;  /* Default: 10 iterations */

	if (argc >= 2) {
		max_iter = strtol(argv[1], NULL, 10);
		if (max_iter <= 0) {
			shell_print(sh, "Usage: pmic monitor [iterations]");
			return -EINVAL;
		}
	}

	shell_print(sh, "Monitoring battery status (Ctrl+C to stop)...");

	while (iterations < max_iter) {
		if (pmic_get_battery_status(&voltage_mv, &percent, &charging) == 0) {
			shell_print(sh, "[%2d] %4u mV | %3u%% | %s",
				   iterations + 1, voltage_mv, percent,
				   charging ? "Charging" : "Discharging");
		}

		iterations++;
		k_sleep(K_SECONDS(1));
	}

	shell_print(sh, "Monitoring stopped (%d iterations)", iterations);
	return 0;
}

/* Shell command: pmic ship (enter ship mode / power off) */
static int cmd_pmic_ship(const struct shell *sh, size_t argc, char **argv)
{
	ARG_UNUSED(argc);
	ARG_UNUSED(argv);

	shell_print(sh, "Entering ship mode (power off)...");
	shell_print(sh, "Wake up: hold button for ~3 seconds");

	/* Give user time to read the message */
	k_sleep(K_SECONDS(1));

	/* Enter ship mode - this will power off the system immediately */
	pmic_enter_ship_mode();

	/* Should not reach here */
	return 0;
}

/* Shell command table */
SHELL_STATIC_SUBCMD_SET_CREATE(sub_pmic,
	SHELL_CMD(status, NULL, "Show battery and charger status", cmd_pmic_status),
	SHELL_CMD_ARG(monitor, NULL, "Monitor battery status [iterations]", cmd_pmic_monitor, 0, 1),
	SHELL_CMD(ship, NULL, "Enter ship mode (power off)", cmd_pmic_ship),
	SHELL_SUBCMD_SET_END
);

/* Root command: pmic */
SHELL_CMD_REGISTER(pmic, &sub_pmic, "PMIC (NPM1300) commands", NULL);
```

## src/pmic.h
```c
/*
 * Copyright (c) 2023 Nordic Semiconductor ASA
 *
 * SPDX-License-Identifier: LicenseRef-Nordic-5-Clause
 */

#ifndef PMIC_H
#define PMIC_H

#include <zephyr/kernel.h>

/**
 * @brief Initialize PMIC (NPM1300)
 * @return 0 on success, negative errno on failure
 */
int pmic_init(void);

/**
 * @brief Get battery status
 * @param voltage_mv Pointer to store voltage in mV
 * @param percent Pointer to store battery percentage
 * @param charging Pointer to store charging state
 * @return 0 on success, negative errno on failure
 */
int pmic_get_battery_status(uint32_t *voltage_mv, uint8_t *percent, bool *charging);

/**
 * @brief Enter ship mode (power off)
 * @return 0 on success, negative errno on failure
 */
int pmic_enter_ship_mode(void);

#endif /* PMIC_H */
```

## src/re_test.c
```c
/*
 * Copyright (c) 2026 Seeed Technology Co., Ltd.
 *
 * SPDX-License-Identifier: LicenseRef-Nordic-5-Clause
 */

#include <zephyr/kernel.h>
#include <zephyr/device.h>
#include <zephyr/drivers/flash.h>
#include <zephyr/audio/dmic.h>
#include <zephyr/fs/fs.h>
#include <zephyr/logging/log.h>
#include <string.h>

#include "re_test.h"
#include "sdcard.h"
#include "oled.h"
#include "motor.h"
#include "pmic.h"
#include "mic.h"
#include "wifi.h"
#include "ble.h"

LOG_MODULE_REGISTER(re_test, LOG_LEVEL_INF);

#define NUM_TESTS 8
#define FLASH_TEST_OFFSET 0x130000

#define MIC_SAMPLE_RATE 16000
#define MIC_SAMPLE_BITS 16
#define MIC_CHANNELS 2
#define MIC_CAPTURE_MS 100
#define MIC_BLOCK_SIZE (((MIC_SAMPLE_BITS / 8) * (MIC_SAMPLE_RATE * MIC_CAPTURE_MS)) / 1000) * MIC_CHANNELS
#define MIC_BLOCK_COUNT 4

K_MEM_SLAB_DEFINE_STATIC(re_mic_slab, MIC_BLOCK_SIZE, MIC_BLOCK_COUNT, 4);

static struct re_test_stats stats[NUM_TESTS] = {
	{ "SD Card",  0, 0 },
	{ "Flash",    0, 0 },
	{ "OLED",     0, 0 },
	{ "Motor",    0, 0 },
	{ "PMIC",     0, 0 },
	{ "MIC",      0, 0 },
	{ "WiFi AP",  0, 0 },
	{ "BLE",      0, 0 },
};

static uint32_t round_count;
static volatile bool stop_requested;

typedef int (*re_test_fn)(void);

/* --- Test wrappers --- */

static int test_sd(void)
{
	int rc;

	if (!sdcard_is_mounted()) {
		rc = sdcard_mount();
		if (rc != 0) {
			return rc;
		}
	}

	struct fs_file_t file;
	char write_buf[256];
	char read_buf[256];

	for (int i = 0; i < sizeof(write_buf); i++) {
		write_buf[i] = (char)(i & 0xFF);
	}

	fs_file_t_init(&file);
	rc = fs_open(&file, "/SD:/re_test.tmp", FS_O_CREATE | FS_O_WRITE | FS_O_RDWR);
	if (rc != 0) {
		return rc;
	}

	rc = fs_write(&file, write_buf, sizeof(write_buf));
	fs_close(&file);
	if (rc < 0) {
		return rc;
	}

	fs_file_t_init(&file);
	rc = fs_open(&file, "/SD:/re_test.tmp", FS_O_READ);
	if (rc != 0) {
		return rc;
	}

	rc = fs_read(&file, read_buf, sizeof(read_buf));
	fs_close(&file);

	fs_unlink("/SD:/re_test.tmp");

	if (rc < 0) {
		return rc;
	}

	if (memcmp(write_buf, read_buf, sizeof(write_buf)) != 0) {
		return -EIO;
	}

	return 0;
}

static int test_flash(void)
{
	const struct device *flash_dev;
	uint8_t write_buf[256];
	uint8_t read_buf[256];
	int rc;

	flash_dev = DEVICE_DT_GET(DT_NODELABEL(spi_flash));
	if (!device_is_ready(flash_dev)) {
		return -ENODEV;
	}

	for (int i = 0; i < sizeof(write_buf); i++) {
		write_buf[i] = (uint8_t)(i ^ 0xAA);
	}

	rc = flash_erase(flash_dev, FLASH_TEST_OFFSET, 4096);
	if (rc != 0) {
		return rc;
	}

	rc = flash_write(flash_dev, FLASH_TEST_OFFSET, write_buf, sizeof(write_buf));
	if (rc != 0) {
		return rc;
	}

	rc = flash_read(flash_dev, FLASH_TEST_OFFSET, read_buf, sizeof(read_buf));
	if (rc != 0) {
		return rc;
	}

	if (memcmp(write_buf, read_buf, sizeof(write_buf)) != 0) {
		return -EIO;
	}

	return 0;
}

static int test_oled(void)
{
	oled_run_all_tests();
	return 0;
}

static int test_motor(void)
{
	int rc = motor_set(true);
	if (rc != 0) {
		return rc;
	}
	k_msleep(100);
	rc = motor_set(false);
	return rc;
}

static int test_pmic(void)
{
	uint32_t voltage_mv;
	uint8_t percent;
	bool charging;

	int rc = pmic_get_battery_status(&voltage_mv, &percent, &charging);
	if (rc != 0) {
		return rc;
	}

	if (voltage_mv == 0) {
		return -EIO;
	}

	LOG_INF("  PMIC: %u mV, %u%%, %s", voltage_mv, percent,
		charging ? "charging" : "discharging");
	return 0;
}

static int test_mic(void)
{
	const struct device *dmic_dev;
	void *buffer = NULL;
	uint32_t size;
	int ret;

	dmic_dev = DEVICE_DT_GET(DT_ALIAS(dmic0));
	if (!device_is_ready(dmic_dev)) {
		return -ENODEV;
	}

	mic_power_on();

	struct pcm_stream_cfg stream = {
		.pcm_rate = MIC_SAMPLE_RATE,
		.pcm_width = MIC_SAMPLE_BITS,
		.block_size = MIC_BLOCK_SIZE,
		.mem_slab = &re_mic_slab,
	};
	struct dmic_cfg cfg = {
		.io = {
			.min_pdm_clk_freq = 1000000,
			.max_pdm_clk_freq = 3500000,
			.min_pdm_clk_dc = 40,
			.max_pdm_clk_dc = 60,
		},
		.streams = &stream,
		.channel = {
			.req_num_streams = 1,
			.req_num_chan = MIC_CHANNELS,
			.req_chan_map_lo =
				dmic_build_channel_map(0, 0, PDM_CHAN_LEFT) |
				dmic_build_channel_map(1, 0, PDM_CHAN_RIGHT),
		},
	};

	ret = dmic_configure(dmic_dev, &cfg);
	if (ret < 0) {
		goto cleanup;
	}

	ret = dmic_trigger(dmic_dev, DMIC_TRIGGER_START);
	if (ret < 0) {
		goto cleanup;
	}

	ret = dmic_read(dmic_dev, 0, &buffer, &size, 2000);
	dmic_trigger(dmic_dev, DMIC_TRIGGER_STOP);

	if (ret < 0 || buffer == NULL) {
		ret = ret < 0 ? ret : -EIO;
		goto cleanup;
	}

	/* Check for non-zero samples */
	int16_t *samples = (int16_t *)buffer;
	uint32_t num_samples = size / sizeof(int16_t);
	int32_t sum = 0;
	for (uint32_t i = 0; i < num_samples; i++) {
		sum += (int32_t)samples[i] > 0 ? samples[i] : -samples[i];
	}

	if (sum == 0) {
		ret = -EIO;
	}

	LOG_INF("  MIC: %u samples, avg_abs=%d", num_samples,
		num_samples > 0 ? (int)(sum / num_samples) : 0);

cleanup:
	if (buffer) {
		k_mem_slab_free(&re_mic_slab, buffer);
	}
	mic_power_off();
	return ret;
}

static int test_wifi(void)
{
	if (wifi_ap_is_running()) {
		return 0;
	}
	return -EIO;
}

static int test_ble(void)
{
	return 0;
}

static re_test_fn test_fns[NUM_TESTS] = {
	test_sd,
	test_flash,
	test_oled,
	test_motor,
	test_pmic,
	test_mic,
	test_wifi,
	test_ble,
};

/* --- OLED status display --- */

static void oled_show_status(int test_idx, bool pass)
{
	oled_test_clear();
	if (pass) {
		oled_test_pattern();
	} else {
		oled_test_fill();
	}
}

/* --- Summary print --- */

static void print_summary(void)
{
	uint32_t total_pass = 0, total_fail = 0;

	printk("\n=== RE Test Round #%u ===\n", round_count);
	for (int i = 0; i < NUM_TESTS; i++) {
		printk("  %-10s: %s\n", stats[i].name,
		       (stats[i].fail > 0 && stats[i].pass == 0) ? "FAIL" : "PASS");

		total_pass += stats[i].pass;
		total_fail += stats[i].fail;
	}

	printk("--- Round #%u done ---\n", round_count);
	printk("Running totals: %u pass, %u fail, %u rounds\n\n",
	       total_pass, total_fail, round_count);
}

/* --- Main test loop --- */

void re_test_request_stop(void)
{
	stop_requested = true;
}

void re_test_loop(void)
{
	printk("\n====== RE Test Starting ======\n");
	printk("Testing %d peripherals in infinite loop\n\n", NUM_TESTS);

	while (!stop_requested) {
		round_count++;

		for (int i = 0; i < NUM_TESTS && !stop_requested; i++) {
			int rc = test_fns[i]();

			if (rc == 0) {
				stats[i].pass++;
				LOG_INF("[%s] PASS", stats[i].name);
			} else {
				stats[i].fail++;
				LOG_INF("[%s] FAIL (err=%d)", stats[i].name, rc);
			}

			oled_show_status(i, rc == 0);
			k_sleep(K_MSEC(500));
		}

		print_summary();
		oled_test_clear();
	}
}
```

## src/re_test.h
```c
/*
 * Copyright (c) 2026 Seeed Technology Co., Ltd.
 *
 * SPDX-License-Identifier: LicenseRef-Nordic-5-Clause
 */

#ifndef RE_TEST_H
#define RE_TEST_H

#include <zephyr/kernel.h>

struct re_test_stats {
	const char *name;
	uint32_t pass;
	uint32_t fail;
};

void re_test_loop(void);

#endif /* RE_TEST_H */
```

## src/sdcard.c
```c
/*
 * Copyright (c) 2023 Nordic Semiconductor ASA
 *
 * SPDX-License-Identifier: LicenseRef-Nordic-5-Clause
 */

#include <zephyr/kernel.h>
#include <zephyr/device.h>
#include <zephyr/storage/disk_access.h>
#include <zephyr/fs/fs.h>
#include <ff.h>
#include <zephyr/logging/log.h>
#include <zephyr/shell/shell.h>
#include <stdio.h>
#include <stdlib.h>
#include <string.h>
#include "sdcard.h"

LOG_MODULE_REGISTER(sdcard, LOG_LEVEL_INF);

static FATFS fat_fs;
static struct fs_mount_t mp = {
	.type = FS_FATFS,
	.fs_data = &fat_fs,
};

static const char *disk_mount_pt = "/SD:";
static bool sd_mounted = false;

bool sdcard_is_mounted(void)
{
	return sd_mounted;
}

int sdcard_unmount(void)
{
	int rc;

	if (!sd_mounted) {
		return 0;
	}

	rc = fs_unmount(&mp);
	if (rc != 0) {
		LOG_ERR("Unmount failed: %d", rc);
		return rc;
	}

	sd_mounted = false;
	LOG_INF("SD card unmounted");
	return 0;
}

int sdcard_mount(void)
{
	int rc;

	if (sd_mounted) {
		return 0;
	}

	rc = disk_access_init("SD");
	if (rc != 0) {
		LOG_ERR("SD card init failed: %d", rc);
		return rc;
	}

	mp.mnt_point = disk_mount_pt;
	rc = fs_mount(&mp);
	if (rc != 0) {
		LOG_ERR("Mount failed: %d", rc);
		return rc;
	}

	sd_mounted = true;
	LOG_INF("SD card mounted at %s", mp.mnt_point);
	return 0;
}

/* Format SD card */
static int cmd_sd_format(const struct shell *sh, size_t argc, char **argv)
{
	int rc;

	if (sd_mounted) {
		shell_print(sh, "Unmounting SD card first...");
		rc = fs_unmount(&mp);
		if (rc != 0) {
			shell_error(sh, "Failed to unmount: %d", rc);
			return rc;
		}
		sd_mounted = false;
	}

	shell_print(sh, "Formatting SD card (this may take a while)...");

	/* Format the SD card */
	rc = fs_mkfs(FS_FATFS, (uintptr_t)disk_mount_pt, NULL, 0);
	if (rc != 0) {
		shell_error(sh, "Format failed: %d", rc);
		return rc;
	}

	shell_print(sh, "Format complete! Mounting...");

	/* Re-mount after format */
	mp.mnt_point = disk_mount_pt;
	rc = fs_mount(&mp);
	if (rc != 0) {
		shell_error(sh, "Mount failed after format: %d", rc);
		return rc;
	}

	sd_mounted = true;
	shell_print(sh, "SD card ready at %s", mp.mnt_point);

	return 0;
}

/* Speed test */
static int cmd_sd_speed(const struct shell *sh, size_t argc, char **argv)
{
	int rc;
	struct fs_file_t file;
	char *write_buf;
	char *read_buf;
	uint32_t file_size = 1024 * 1024; /* 1MB test file */
	uint32_t chunk_size = 4096;
	uint64_t start_time, end_time, write_time, read_time;

	if (!sd_mounted) {
		shell_error(sh, "SD card not mounted");
		return -ENODEV;
	}

	/* Parse optional file size argument */
	if (argc >= 2) {
		file_size = atoi(argv[1]) * 1024; /* Convert KB to bytes */
		if (file_size < 1024) file_size = 1024;
		if (file_size > 10 * 1024 * 1024) file_size = 10 * 1024 * 1024; /* Max 10MB */
	}

	shell_print(sh, "SD card speed test (file size: %u KB)...", file_size / 1024);

	/* Allocate buffers */
	write_buf = k_malloc(chunk_size);
	read_buf = k_malloc(chunk_size);
	if (!write_buf || !read_buf) {
		shell_error(sh, "Failed to allocate buffers");
		rc = -ENOMEM;
		goto cleanup;
	}

	/* Fill write buffer with pattern */
	for (uint32_t i = 0; i < chunk_size; i++) {
		write_buf[i] = (char)(i & 0xFF);
	}

	/* Write test */
	shell_print(sh, "Write test...");
	fs_file_t_init(&file);
	rc = fs_open(&file, "/SD:/speedtest.tmp", FS_O_CREATE | FS_O_WRITE);
	if (rc != 0) {
		shell_error(sh, "Failed to create file: %d", rc);
		goto cleanup;
	}

	start_time = k_uptime_get();
	uint32_t total_written = 0;
	while (total_written < file_size) {
		uint32_t to_write = chunk_size;
		if (total_written + to_write > file_size) {
			to_write = file_size - total_written;
		}

		rc = fs_write(&file, write_buf, to_write);
		if (rc < 0) {
			shell_error(sh, "Write failed: %d", rc);
			fs_close(&file);
			goto cleanup;
		}
		total_written += rc;
	}
	fs_close(&file);
	end_time = k_uptime_get();

	write_time = end_time - start_time;
	uint32_t write_speed_kb = (file_size / 1024 * 1000) / write_time; /* KB/s */

	/* Read test */
	shell_print(sh, "Read test...");
	rc = fs_open(&file, "/SD:/speedtest.tmp", FS_O_READ);
	if (rc != 0) {
		shell_error(sh, "Failed to open file: %d", rc);
		goto cleanup;
	}

	start_time = k_uptime_get();
	uint32_t total_read = 0;
	while (total_read < file_size) {
		uint32_t to_read = chunk_size;
		if (total_read + to_read > file_size) {
			to_read = file_size - total_read;
		}

		rc = fs_read(&file, read_buf, to_read);
		if (rc < 0) {
			shell_error(sh, "Read failed: %d", rc);
			fs_close(&file);
			goto cleanup;
		}
		total_read += rc;
	}
	fs_close(&file);
	end_time = k_uptime_get();

	read_time = end_time - start_time;
	uint32_t read_speed_kb = (file_size / 1024 * 1000) / read_time; /* KB/s */

	/* Print results */
	shell_print(sh, "");
	shell_print(sh, "=== SD Card Speed Test Results ===");
	shell_print(sh, "File size: %u KB", file_size / 1024);
	shell_print(sh, "Write: %u KB/s (%u ms)", write_speed_kb, (uint32_t)write_time);
	shell_print(sh, "Read:  %u KB/s (%u ms)", read_speed_kb, (uint32_t)read_time);
	shell_print(sh, "================================");

	/* Delete test file */
	fs_unlink("/SD:/speedtest.tmp");
	shell_print(sh, "Test file deleted");

	rc = 0;

cleanup:
	if (write_buf) k_free(write_buf);
	if (read_buf) k_free(read_buf);
	return rc;
}

/* Shell command to show SD card status */
static int cmd_sd_status(const struct shell *sh, size_t argc, char **argv)
{
	if (sd_mounted) {
		shell_print(sh, "SD card status: MOUNTED at %s", disk_mount_pt);
	} else {
		shell_print(sh, "SD card status: NOT MOUNTED");
	}

	return 0;
}

/* Mount SD card */
static int cmd_sd_mount(const struct shell *sh, size_t argc, char **argv)
{
	if (sd_mounted) {
		shell_print(sh, "SD card already mounted at %s", disk_mount_pt);
		return 0;
	}

	shell_print(sh, "Mounting SD card...");
	int rc = sdcard_mount();
	if (rc != 0) {
		shell_error(sh, "Mount failed: %d (not formatted?)", rc);
		shell_print(sh, "Use 'sd format' to format the SD card");
	}

	return rc;
}

/* Unmount SD card */
static int cmd_sd_umount(const struct shell *sh, size_t argc, char **argv)
{
	if (!sd_mounted) {
		shell_print(sh, "SD card not mounted");
		return 0;
	}

	shell_print(sh, "Unmounting SD card...");
	int rc = sdcard_unmount();
	if (rc != 0) {
		shell_error(sh, "Unmount failed: %d", rc);
	} else {
		shell_print(sh, "SD card unmounted");
	}

	return rc;
}

SHELL_STATIC_SUBCMD_SET_CREATE(sd_cmds,
	SHELL_CMD(mount, NULL, "Mount SD card", cmd_sd_mount),
	SHELL_CMD(umount, NULL, "Unmount SD card", cmd_sd_umount),
	SHELL_CMD(format, NULL, "Format SD card as FAT32", cmd_sd_format),
	SHELL_CMD_ARG(speed, NULL, "Speed test [size_kb]", cmd_sd_speed, 1, 1),
	SHELL_CMD(status, NULL, "Show SD card status", cmd_sd_status),
	SHELL_SUBCMD_SET_END
);

SHELL_CMD_REGISTER(sd, &sd_cmds, "SD card commands", NULL);

int sdcard_init(void)
{
	LOG_INF("Initializing SD card...");

	int rc = sdcard_mount();
	if (rc != 0) {
		LOG_WRN("SD card mount failed: %d (not formatted?)", rc);
		LOG_INF("Use 'sd format' to format the SD card as FAT32");
		return 0;
	}

	LOG_INF("Commands: sd status, sd speed [size_kb], sd format");
	return 0;
}
```

## src/sdcard.h
```c
/*
 * Copyright (c) 2023 Nordic Semiconductor ASA
 *
 * SPDX-License-Identifier: LicenseRef-Nordic-5-Clause
 */

#ifndef SDCARD_H_
#define SDCARD_H_

/**
 * @brief Initialize SD card and register shell commands
 * Shell commands:
 *   sd mount  - Mount SD card
 *   sd umount - Unmount SD card
 *   sd status - Show SD card status
 *
 * @return 0 on success, negative error code on failure
 */
int sdcard_init(void);

bool sdcard_is_mounted(void);
int sdcard_mount(void);
int sdcard_unmount(void);

#endif /* SDCARD_H_ */
```

## src/usb.c
```c
/*
 * USB Mass Storage Class module
 * Exposes SD card as a USB drive for direct file access from PC.
 *
 * Usage:
 *   usb msc on   - Unmount SD from filesystem, enable USB MSC
 *   usb msc off  - Disable USB MSC, remount SD filesystem
 */

#include <zephyr/kernel.h>
#include <zephyr/device.h>
#include <zephyr/usb/usbd.h>
#include <zephyr/usb/class/usbd_msc.h>
#include <zephyr/storage/disk_access.h>
#include <zephyr/fs/fs.h>
#include <zephyr/shell/shell.h>
#include <zephyr/logging/log.h>
#include "usb.h"
#include "sdcard.h"

LOG_MODULE_REGISTER(usb_msc, LOG_LEVEL_INF);

/* USB device context - using new USB stack */
USBD_DEVICE_DEFINE(sample_usbd,
		   DEVICE_DT_GET(DT_NODELABEL(usbd)),
		   0x2886, 0x0047);

USBD_DESC_LANG_DEFINE(sample_lang);
USBD_DESC_MANUFACTURER_DEFINE(sample_mfr, "Seeed");
USBD_DESC_PRODUCT_DEFINE(sample_product, "Clip Test");

USBD_DESC_CONFIG_DEFINE(fs_cfg_desc, "FS Configuration");

USBD_CONFIGURATION_DEFINE(sample_fs_config,
			  0, 100, &fs_cfg_desc);

/* SD card as MSC LUN */
USBD_DEFINE_MSC_LUN(sd, "SD", "Seeed", "Clip SD", "1.00");

static bool msc_enabled;
static bool usbd_initialized;

static int usbd_setup(void)
{
	int err;

	err = usbd_add_descriptor(&sample_usbd, &sample_lang);
	if (err) {
		LOG_ERR("Failed to add language descriptor: %d", err);
		return err;
	}

	err = usbd_add_descriptor(&sample_usbd, &sample_mfr);
	if (err) {
		LOG_ERR("Failed to add manufacturer descriptor: %d", err);
		return err;
	}

	err = usbd_add_descriptor(&sample_usbd, &sample_product);
	if (err) {
		LOG_ERR("Failed to add product descriptor: %d", err);
		return err;
	}

	err = usbd_add_configuration(&sample_usbd, USBD_SPEED_FS,
				     &sample_fs_config);
	if (err) {
		LOG_ERR("Failed to add FS configuration: %d", err);
		return err;
	}

	err = usbd_register_all_classes(&sample_usbd, USBD_SPEED_FS, 1, NULL);
	if (err) {
		LOG_ERR("Failed to register classes: %d", err);
		return err;
	}

	err = usbd_init(&sample_usbd);
	if (err) {
		LOG_ERR("Failed to init USBD: %d", err);
		return err;
	}

	usbd_initialized = true;
	return 0;
}

static int cmd_usb_msc_on(const struct shell *sh, size_t argc, char **argv)
{
	ARG_UNUSED(argc);
	ARG_UNUSED(argv);

	if (msc_enabled) {
		shell_print(sh, "USB MSC already enabled");
		return 0;
	}

	/* Unmount SD filesystem first */
	if (sdcard_is_mounted()) {
		shell_print(sh, "Unmounting SD card...");
		sdcard_unmount();
		k_sleep(K_MSEC(100));
	}

	/* Initialize USB device if needed */
	if (!usbd_initialized) {
		int ret = usbd_setup();
		if (ret != 0) {
			shell_error(sh, "USB init failed: %d", ret);
			return ret;
		}
	}

	/* Enable USB device */
	int ret = usbd_enable(&sample_usbd);
	if (ret != 0) {
		shell_error(sh, "USB enable failed: %d", ret);
		return ret;
	}

	msc_enabled = true;
	shell_print(sh, "USB MSC enabled - SD card visible as USB drive");
	shell_print(sh, "Connect USB cable to PC to access files");
	shell_print(sh, "Use 'usb msc off' to disable and remount SD");
	return 0;
}

static int cmd_usb_msc_off(const struct shell *sh, size_t argc, char **argv)
{
	ARG_UNUSED(argc);
	ARG_UNUSED(argv);

	if (!msc_enabled) {
		shell_print(sh, "USB MSC not enabled");
		return 0;
	}

	/* Disable USB device */
	int ret = usbd_disable(&sample_usbd);
	if (ret != 0) {
		LOG_WRN("USB disable failed: %d", ret);
	}

	msc_enabled = false;
	k_sleep(K_MSEC(200));

	/* Remount SD card */
	shell_print(sh, "Remounting SD card...");
	sdcard_mount();

	shell_print(sh, "USB MSC disabled, SD card remounted");
	return 0;
}

static int cmd_usb_status(const struct shell *sh, size_t argc, char **argv)
{
	ARG_UNUSED(argc);
	ARG_UNUSED(argv);

	shell_print(sh, "USB MSC: %s", msc_enabled ? "enabled" : "disabled");
	shell_print(sh, "SD card: %s", sdcard_is_mounted() ? "mounted" : "unmounted");
	return 0;
}

SHELL_STATIC_SUBCMD_SET_CREATE(sub_usb_msc,
	SHELL_CMD(on, NULL, "Enable USB MSC (expose SD card)", cmd_usb_msc_on),
	SHELL_CMD(off, NULL, "Disable USB MSC (remount SD)", cmd_usb_msc_off),
	SHELL_SUBCMD_SET_END
);

SHELL_STATIC_SUBCMD_SET_CREATE(sub_usb,
	SHELL_CMD(msc, &sub_usb_msc, "USB Mass Storage commands", NULL),
	SHELL_CMD(status, NULL, "Show USB status", cmd_usb_status),
	SHELL_SUBCMD_SET_END
);

SHELL_CMD_REGISTER(usb, &sub_usb, "USB commands", NULL);

int usb_msc_init(void)
{
	LOG_INF("USB MSC module ready (use 'usb msc on' to enable)");
	return 0;
}
```

## src/wifi.h
```c
/*
 * Copyright (c) 2023 Nordic Semiconductor ASA
 *
 * SPDX-License-Identifier: LicenseRef-Nordic-5-Clause
 */

#ifndef WIFI_H__
#define WIFI_H__

#include <zephyr/kernel.h>

/**
 * @brief Initialize WiFi AP mode
 *
 * Generates SSID from chip ID and registers event callbacks.
 * Use 'wifi on' shell command to actually start the AP.
 *
 * @return 0 on success, negative errno on failure
 */
int wifi_init_and_connect(void);

/**
 * @brief Start WiFi throughput test
 *
 * @return 0 on success, negative errno on failure
 */
int wifi_start_throughput_test(void);

/**
 * @brief Run WiFi initialization
 * This function initializes WiFi AP mode.
 *
 * @return 0 on success, negative errno on failure
 */
int wifi_run_test(void);

bool wifi_ap_is_running(void);

#endif /* WIFI_H__ */
```
