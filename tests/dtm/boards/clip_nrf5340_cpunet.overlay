/*
 * Copyright (c) 2024 Seeed Studio
 *
 * SPDX-License-Identifier: LicenseRef-Nordic-5-Clause
 */

/ {
	chosen {
		ncs,dtm-uart = &uart_ipc;
	};

	uart_ipc: uart_ipc {
		status = "okay";
		compatible = "nordic,nrf-ipc-uart";
		ipc = <&ipc0>;
		ept-name = "remote shell";
		current-speed = <19200>;
	};
};

&radio {
	status = "okay";
};
