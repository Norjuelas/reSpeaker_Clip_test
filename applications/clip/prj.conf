## CMakeLists.txt
```
# SPDX-License-Identifier: Apache-2.0

cmake_minimum_required(VERSION 3.20)

find_package(Zephyr REQUIRED HINTS $ENV{ZEPHYR_BASE})
project(clip)

# Include directories
target_include_directories(app PRIVATE include)

# Source files
target_sources(app PRIVATE
    src/main.c
    src/clip_event.c
    src/config.c
    src/transport.c
    src/at_server.c
    src/at_commands.c
    src/audio.c
    src/storage.c
    src/transfer.c
    src/haptic.c
    src/button.c
    src/display.c
    src/icons.c
    src/http_upload.c
    src/health.c
    src/upload_registry.c
    src/nrf70_fw_provision.c
    src/wifi.c
    src/battery.c
    src/usb_cdc.c
)

if(CONFIG_CLIP_MTLS)
    # Credenciales de cliente del device (Doc 23 Fase 2).
    target_sources(app PRIVATE src/mtls.c)
endif()

if(CONFIG_CLIP_SECURITY_BUILTIN_CA)
    # La CA de flota dentro de la imagen firmada. Se rellena con
    # tools/gen_ca_builtin.py contra el servicio de produccion.
    target_sources(app PRIVATE src/ca_builtin.c)
endif()

if(CONFIG_CLIP_AUDIO_ENCRYPT)
    target_sources(app PRIVATE src/audio_crypto.c)
endif()


# Bluetooth: la implementacion real, o una superficie vacia. Sacar el host BT
# libera ~15KB de FLASH, que es lo que faltaba para que TLS entrara. Volver
# atras es CONFIG_BT=y — ningun sitio de llamada cambia. Ver Doc 14.
if(CONFIG_BT)
    target_sources(app PRIVATE src/ble.c src/transport_ble.c)
else()
    target_sources(app PRIVATE src/ble_stub.c)
endif()

# Transporte UDP: el real, o una superficie vacia. Se retira por seguridad — el
# canal AT por red no pide credenciales — y de paso libera FLASH. Volver atras
# es CLIP_UDP_TRANSPORT=y, sin tocar ningun sitio de llamada.
if(CONFIG_CLIP_UDP_TRANSPORT)
    target_sources(app PRIVATE src/wifi_udp.c src/transport_udp.c)
else()
    target_sources(app PRIVATE src/udp_stub.c)
endif()
```

## sysbuild.conf
```
# Keep the nRF70 patch out of the internal image (~87KB).
#
# This symbol is what makes the app read the patch from nrf70_fw_partition —
# setting CONFIG_NRF_WIFI_PATCHES_EXT_FLASH_STORE in prj.conf alone does not
# work, sysbuild propagates its own value and overrides it.
#
# It normally also pushes MCUBOOT_UPDATEABLE_IMAGES to 3, which produces images
# the deployed bootloader rejects. The board's Kconfig.sysbuild pins the count
# at 2 to stop that: the partition exists and is read, but MCUboot does not
# manage it. The application provisions its contents from the SD card instead.
# See applications/clip/src/nrf70_fw_provision.c and Doc 07.
SB_CONFIG_WIFI_PATCHES_EXT_FLASH_STORE=y
```

## overlay-dev-radio.conf
```kconfig
# Radios de vuelta, SOLO para desarrollo.
#
#   west build --build-dir build-dev --board clip/nrf5340/cpuapp applications/clip \
#     -- -DEXTRA_CONF_FILE=$(pwd)/applications/clip/overlay-dev-radio.conf
#
# Devuelve BLE (canal AT por Bluetooth, SDKs de mobile/, OTA por BLE) y el modo
# punto de acceso. Una imagen construida con esto NO es desplegable en tienda:
# son dos canales de radio sin autenticar, y el modo AP levanta un SSID con la
# misma contrasena en todas las unidades.
#
# Si esta imagen acaba en un device de campo, la afirmacion "el device no tiene
# canales de radio sin autenticar" del informe de seguridad deja de ser cierta.
# Marca el device y reflashealo antes de devolverlo al inventario.

CONFIG_BT=y
CONFIG_NRF70_AP_MODE=y

# TLS no cabe junto a BLE: el presupuesto de FLASH no da para las dos cosas
# (TLS recortado son ~38KB y BLE ~15KB sobre una imagen que iba al 97%). Una
# imagen de desarrollo con radio, por tanto, sube el audio SIN cifrar en
# transito. Otra razon para no sacarla del banco.
CONFIG_CLIP_UPLOAD_TLS=n
```

## overlay-tls.conf
```kconfig
# OBSOLETO desde 2026-08-18 — su contenido vive ahora en prj.conf.
#
# Este overlay encendia TLS y apagaba BLE y el modo AP. Se pasaba a mano con
# -DEXTRA_CONF_FILE, y esa era exactamente la fragilidad: build-prod y
# build-relcheck-prod se compilaron sin el, o sea SIN TLS y CON las dos radios
# abiertas, mientras la documentacion de seguridad decia lo contrario.
#
# La postura segura ya es la que sale de `west build` sin argumentos extra.
# Pasarlo ahora no rompe nada (queda vacio), pero no hace falta.
#
# Para desarrollo con BLE o modo AP:
#   west build ... -- -DEXTRA_CONF_FILE=$(pwd)/applications/clip/overlay-dev-radio.conf
```

## boards/clip_nrf5340_cpuapp.overlay
```dts
/*
 * Copyright (c) 2025 Seeed Technology Co., Ltd.
 *
 * SPDX-License-Identifier: Apache-2.0
 */

/* Device tree overlay for Clip application */

/ {
    /* Reserved for future use */
};

/* Enable display for UI module */
&ch1115 {
    status = "okay";
};

&i2c2 {
    status = "okay";
};
```

## src/main.c
```c
/*
 * Copyright (c) 2025 Seeed Technology Co., Ltd.
 *
 * SPDX-License-Identifier: Apache-2.0
 */

#include <zephyr/kernel.h>
#include <zephyr/logging/log.h>
#include <zephyr/logging/log_backend.h>
#include <zephyr/logging/log_ctrl.h>
#include <zephyr/drivers/regulator.h>
#include <app_version.h>
#include <zephyr/sys/util.h>
#include <zephyr/sys/mem_stats.h>
#include <zephyr/sys/sys_heap.h>

#include <nrfx_clock.h>
#include <hal/nrf_oscillators.h>

#include "clip.h"
#include "config.h"
#include "ble.h"
#include "transport.h"
#include "transport_ble.h"
#include "at_server.h"
#include "at_commands.h"
#include "audio.h"
#include "storage.h"
#include "transfer.h"
#include "button.h"
#include "display.h"
#include "wifi.h"
#include "nrf70_fw_provision.h"
#include "wifi_udp.h"
#include "transport_udp.h"
#include "clip_event.h"
#include "battery.h"
#include "haptic.h"
#include "usb_cdc.h"
#include "http_upload.h"
#include "health.h"

LOG_MODULE_REGISTER(main, CONFIG_CLIP_LOG_LEVEL);

/* Global context */
static struct clip_context g_ctx;

struct clip_context *clip_get_context(void)
{
    return &g_ctx;
}

const char *clip_state_to_string(enum clip_state state)
{
    switch (state) {
    case CLIP_STATE_UNINITIALIZED:
        return "UNINITIALIZED";
    case CLIP_STATE_IDLE:
        return "IDLE";
    case CLIP_STATE_RECORDING:
        return "RECORDING";
    case CLIP_STATE_TRANSMITTING:
        return "TRANSMITTING";
    case CLIP_STATE_WIFI_SYNC:
        return "WIFI_SYNC";
    case CLIP_STATE_PAUSED:
        return "PAUSED";
    case CLIP_STATE_ERROR:
        return "ERROR";
    case CLIP_STATE_OTA:
        return "OTA";
    default:
        return "UNKNOWN";
    }
}

bool clip_get_current_time(uint16_t *out_year, uint8_t *out_month, uint8_t *out_day,
                           uint8_t *out_hour, uint8_t *out_min, uint8_t *out_sec)
{
    uint32_t sec;

    if (!g_ctx.time.valid) {
        return false;
    }

    /* Calculate elapsed time since sync */
    int64_t current_uptime = k_uptime_get();
    int64_t elapsed_ms = current_uptime - g_ctx.time.base_uptime_ms;

    if (elapsed_ms < 0) {
        elapsed_ms = 0;
    }

    /* Convert to seconds */
    uint32_t elapsed_sec = (uint32_t)(elapsed_ms / 1000);

    /* Start from synced time */
    uint16_t year = g_ctx.time.year;
    uint8_t month = g_ctx.time.month;
    uint8_t day = g_ctx.time.day;
    uint8_t hour = g_ctx.time.hour;
    uint8_t min = g_ctx.time.min;
    sec = g_ctx.time.sec;

    /* Add elapsed seconds */
    sec += elapsed_sec;

    /* Handle overflow */
    while (sec >= 60) {
        sec -= 60;
        min++;
    }
    while (min >= 60) {
        min -= 60;
        hour++;
    }
    while (hour >= 24) {
        hour -= 24;
        day++;
    }

    /* Simple day overflow handling */
    uint8_t days_in_month[] = {31, 28, 31, 30, 31, 30, 31, 31, 30, 31, 30, 31};
    if ((year % 4 == 0 && year % 100 != 0) || (year % 400 == 0)) {
        days_in_month[1] = 29;
    }

    while (day > days_in_month[month - 1]) {
        day -= days_in_month[month - 1];
        month++;
        if (month > 12) {
            month = 1;
            year++;
        }
    }

    *out_year = year;
    *out_month = month;
    *out_day = day;
    *out_hour = hour;
    *out_min = min;
    *out_sec = (uint8_t)sec;

    return true;
}

int clip_init(void)
{
    int err;

    LOG_INF("Initializing Clip...");

    /* Initialize context */

    /* Initialize configuration (will set defaults and load from storage) */
    err = config_init();
    if (err) {
        LOG_WRN("Config init failed: %d, using defaults", err);
        /* Continue anyway - config is optional */
    }

    /* Initialize battery monitoring before display so first render has real data */
    err = battery_init();
    if (err) {
        LOG_WRN("Battery init failed: %d", err);
        /* Continue anyway - battery is optional */
    }

    /* Initialize haptic motor before display (boot animation uses it) */
    err = haptic_init();
    if (err) {
        LOG_WRN("Haptic init failed: %d", err);
    }

    /* Initialize display early (before slow BLE init) to light up screen */
    err = display_init();
    if (err) {
        LOG_WRN("Display init failed: %d", err);
        /* Continue anyway - display is optional */
    }

    /* Start boot animation (runs in background while init continues) */
    display_boot_animation_start();

    /* Initialize BLE (bt_enable is slow, display is already showing) */
    err = ble_init();
    if (err) {
        LOG_ERR("BLE init failed: %d", err);
        return err;
    }

    /* Initialize transport layer */
    err = transport_init();
    if (err) {
        LOG_ERR("Transport init failed: %d", err);
        return err;
    }

#ifdef CONFIG_BT
    /* Initialize BLE transport (now that BLE is ready) */
    err = transport_ble_init();
    if (err) {
        LOG_ERR("BLE transport init failed: %d", err);
        return err;
    }

    /* Register BLE transport */
    err = transport_register(transport_ble_get());
    if (err) {
        LOG_ERR("BLE transport register failed: %d", err);
        return err;
    }
#endif /* CONFIG_BT */

    /* Initialize UDP transport */
    err = transport_udp_init();
    if (err) {
        LOG_WRN("UDP transport init failed: %d", err);
        /* Continue anyway - UDP is optional */
    }

    /* Register UDP transport */
    err = transport_register(transport_udp_get());
    if (err) {
        LOG_WRN("UDP transport register failed: %d", err);
        /* Continue anyway - UDP is optional */
    }

    /* Initialize audio subsystem */
    err = audio_init();
    if (err) {
        LOG_ERR("Audio init failed: %d", err);
        return err;
    }

    /* Initialize storage subsystem */
    err = storage_init();
    if (err) {
        LOG_WRN("Storage init failed: %d", err);
        /* Continue anyway - storage is optional */
    } else {
        /* SD card mounted - check for unsynced sessions */
        display_check_untransferred();

#ifdef CONFIG_LOG_BACKEND_FS
        const struct log_backend *fs_be = log_backend_get_by_name("log_backend_fs");
        if (fs_be) {
            if (IS_ENABLED(CONFIG_CLIP_LOG_FS_DEFAULT_ON)) {
                /* Debug: FS log on by default (WRN+ERR to /SD:/LOG) */
                log_backend_activate(fs_be, NULL);
                uint32_t src_cnt = log_src_cnt_get(0);
                for (uint32_t i = 0; i < src_cnt; i++) {
                    log_filter_set(fs_be, 0, (int16_t)i, LOG_LEVEL_INF);
                }
            } else {
                /* Production: FS log off (enable via AT+LOG) */
                log_backend_deactivate(fs_be);
            }
        }
#endif
    }

    /* Initialize USB CDC ACM + MSC (serial port + SD card drive) */
    err = usb_cdc_init();
    if (err) {
        LOG_WRN("USB init failed: %d", err);
    }

#ifdef CONFIG_CLIP_USB_AT_AT_BOOT
    /* Bring the USB AT channel up without waiting for AT+USB=on, which only
     * arrives over BLE. A lost bond otherwise leaves no way in at all: the
     * bootloader has no BLE, the app has no console under the production
     * snippet, and the SD logs need an AT command to enable. A cable is the
     * one link that always works. */
    err = usb_cdc_enable();
    if (err) {
        LOG_WRN("USB AT channel not enabled: %d", err);
    }
#endif

    /* Initialize transfer subsystem */
    err = transfer_init();
    if (err) {
        LOG_WRN("Transfer init failed: %d", err);
        /* Continue anyway - transfer is optional */
    }

    /* The nRF7002 patch lives in a flash partition, not in this image. Fill it
     * from the SD card before WiFi comes up — an empty partition makes
     * net_if_up() fail with -EIO and takes both AP and station mode down. */
    err = nrf70_fw_provision();
    if (err) {
        LOG_WRN("nRF70 patch not provisioned: %d — WiFi will not start", err);
    }

    /* Initialize WiFi subsystem */
    err = wifi_init();
    if (err) {
        LOG_WRN("WiFi init failed: %d", err);
        /* Continue anyway - WiFi is optional */
    }

    /* Initialize WiFi UDP server */
    err = wifi_udp_init();
    if (err) {
        LOG_WRN("WiFi UDP init failed: %d", err);
        /* Continue anyway - UDP is optional */
    }

    /* The thread that carries HTTP uploads, so they never sit on the AT
     * channel. Only starts a work queue; it costs nothing until something is
     * queued onto it. */
    err = http_upload_init();
    if (err) {
        LOG_WRN("HTTP upload init failed: %d", err);
        /* Continue anyway - uploads are optional */
    }

    /* Health heartbeat. Also reads the reset cause, which is why it runs even
     * when there is no endpoint yet: a device that rebooted on a watchdog
     * should be able to say so once someone configures where to say it. */
    err = health_init();
    if (err) {
        LOG_WRN("Health init failed: %d", err);
    }

#ifdef CONFIG_CLIP_STA_AUTOCONNECT
    /* Join the stored network without waiting to be told. Otherwise reaching
     * the network requires AT+STA=on over BLE, so a broken bond takes WiFi
     * down with it — and the credentials are already on disk. Non-blocking:
     * association plus DHCP runs on its own work queue. */
    if (config_has_sta_credentials()) {
        err = wifi_sta_connect_async_delayed(CONFIG_CLIP_STA_AUTOCONNECT_DELAY_MS);
        if (err) {
            LOG_WRN("STA autoconnect not scheduled: %d", err);
        }
    }
#endif

    /* Register AT commands BEFORE starting server thread */
    err = at_commands_register();
    if (err) {
        LOG_ERR("AT commands register failed: %d", err);
        return err;
    }

    /* Initialize AT server (commands must be registered first) */
    err = at_server_init();
    if (err) {
        LOG_ERR("AT server init failed: %d", err);
        return err;
    }

    /* Initialize button handler */
    err = button_init();
    if (err) {
        LOG_WRN("Button init failed: %d", err);
        /* Continue anyway - button is optional */
    }

    /* Initialize event dispatcher (depends on audio, haptic, display, wifi) */
    err = clip_event_init();
    if (err) {
        LOG_ERR("Event dispatcher init failed: %d", err);
        return err;
    }

    /* Clear status (battery_percent/charging set by battery_init) */
    g_ctx.status.recording_time = 0;
    g_ctx.status.free_space = 0;
    g_ctx.status.session_count = 0;

    /* Transition to idle state */
    clip_event_get_state();  /* Already set by clip_event_init */

    LOG_INF("Clip initialized successfully");
    LOG_INF("ready: normal=%u/%u enhanced=%u/%u",
           CONFIG_CLIP_NORMAL_BITRATE, CONFIG_CLIP_NORMAL_COMPLEXITY,
           CONFIG_CLIP_ENHANCED_BITRATE, CONFIG_CLIP_ENHANCED_COMPLEXITY);

    return 0;
}

extern struct k_heap _system_heap;

static void thread_stack_stats_cb(const struct k_thread *thread, void *user_data)
{
	ARG_UNUSED(user_data);

	size_t stack_size, free_bytes;

#ifdef CONFIG_THREAD_STACK_INFO
	stack_size = thread->stack_info.size;
	if (k_thread_stack_space_get(thread, &free_bytes) == 0) {
		size_t used = stack_size - free_bytes;
		const char *name = k_thread_name_get(
			(struct k_thread *)thread);
		if (!name || name[0] == '\0') {
			name = "?";
		}
		LOG_INF("  %-20s %5u/%5u (%2u%%)",
			name, used, stack_size,
			stack_size > 0 ? (uint32_t)(used * 100 / stack_size) : 0);
	}
#endif
}

void clip_main_loop(void)
{
    LOG_INF("Entering main loop");

    int stats_counter = 0;

    while (true) {
        /* Use K_FOREVER when not recording to allow deep idle;
         * use 1s timeout during recording for time tracking */
        k_timeout_t wait = (clip_event_get_state() == CLIP_STATE_RECORDING)
                           ? K_MSEC(1000) : K_FOREVER;
        clip_event_wait(wait);

        /* Process all pending events */
        clip_event_process();

        /* Update recording time if recording */
        if (clip_event_get_state() == CLIP_STATE_RECORDING) {
            g_ctx.status.recording_time++;
        }

        /* Print thread stack stats every 10 seconds */
        if (IS_ENABLED(CONFIG_CLIP_DEBUG_STATS) && ++stats_counter >= 10) {
            stats_counter = 0;

            LOG_INF("--- Thread Stack Usage ---");
            k_thread_foreach(thread_stack_stats_cb, NULL);

            /* Heap usage */
            struct sys_memory_stats hs;
            if (sys_heap_runtime_stats_get(&_system_heap.heap, &hs) == 0) {
                LOG_INF("  HEAP: %u/%u used (peak %u)",
                        hs.allocated_bytes,
                        hs.allocated_bytes + hs.free_bytes,
                        hs.max_allocated_bytes);
            }
        }
    }
}

/*
 * Crystal load-capacitor tuning.
 *
 * The board has no external load capacitors for the HFXO (32 MHz) or LFXO
 * (32.768 kHz); the internal ones must be enabled through the OSCILLATORS
 * peripheral. The values below were tuned with the tests/clip `hfxo`/`lfxo`
 * shell and are written here the same way — as raw register fields, not via
 * the DTS femtofarad/picofarad properties (the HFXO DTS binding cannot take a
 * raw CAPVALUE; it derives one from per-chip FICR, which is not what we want).
 *
 * SoC init writes these registers once at boot (PRE_KERNEL) from the DTS;
 * this runs afterwards (POST_KERNEL) and overrides with the tuned values.
 * Neither register is touched again at runtime, so the override sticks.
 */
static int clip_xo_cap_init(void)
{
	NRF_OSCILLATORS->XOSC32MCAPS =
		(OSCILLATORS_XOSC32MCAPS_ENABLE_Enabled <<
		 OSCILLATORS_XOSC32MCAPS_ENABLE_Pos) |
		(CONFIG_CLIP_HFXO_CAPVALUE << OSCILLATORS_XOSC32MCAPS_CAPVALUE_Pos);
	NRF_OSCILLATORS->XOSC32KI.INTCAP = CONFIG_CLIP_LFXO_INTCAP;
	return 0;
}
SYS_INIT(clip_xo_cap_init, POST_KERNEL, 0);

int main(void)
{
    /* Print version and build info at startup */
    LOG_INF("Clip Firmware v%s", CLIP_VERSION);
    LOG_INF("Build: %s %s", __DATE__, __TIME__);

    int err;

    /* Initialize application */
    err = clip_init();
    if (err) {
        LOG_ERR("Application init failed: %d", err);
        return err;
    }

    /* Enter main loop */
    clip_main_loop();

    return 0;
}
```

## include/at_commands.h
```c
/*
 * Copyright (c) 2025 Seeed Technology Co., Ltd.
 *
 * SPDX-License-Identifier: Apache-2.0
 */

#ifndef CLIP_AT_COMMANDS_H
#define CLIP_AT_COMMANDS_H

#include <zephyr/kernel.h>
#include "at_server.h"

/**
 * @brief Register all AT commands
 *
 * @return 0 on success, negative error code on failure
 */
int at_commands_register(void);

#endif /* CLIP_AT_COMMANDS_H */
```

## include/at_server.h
```c
/*
 * Copyright (c) 2025 Seeed Technology Co., Ltd.
 *
 * SPDX-License-Identifier: Apache-2.0
 */

#ifndef CLIP_AT_SERVER_H
#define CLIP_AT_SERVER_H

#include <zephyr/kernel.h>
#include <stdbool.h>
#include <stdint.h>

/* AT Command Types */
#define AT_CMD_TYPE_TEST   0  /* AT+CMD? - Query */
#define AT_CMD_TYPE_SET    1  /* AT+CMD=... - Set */
#define AT_CMD_TYPE_EXEC   2  /* AT+CMD - Execute */
#define AT_CMD_TYPE_READ   3  /* AT+CMD? - Read (same as TEST) */

/* AT Server Error Codes */
#define AT_OK              0   /* Success */
#define AT_ERR_PARSE       1   /* Command parsing error */
#define AT_ERR_PARAM       2   /* Parameter error */
#define AT_ERR_STATE       3   /* State error */
#define AT_ERR_NOMEM       4   /* Memory insufficient */
#define AT_ERR_STORAGE     5   /* Storage error */
#define AT_ERR_NETWORK     6   /* Network error */
#define AT_ERR_TIMEOUT     7   /* Timeout */
#define AT_ERR_NOT_FOUND   8   /* Resource not found */
#define AT_ERR_NOT_ALLOWED 9   /* Operation not allowed */

/* AT Command Flags */
#define AT_CMD_SET    (1 << 0)  /* Supports SET operation */
#define AT_CMD_QUERY  (1 << 1)  /* Supports QUERY operation */
#define AT_CMD_EXEC   (1 << 2)  /* Supports EXEC operation */

/* AT Command Context */
struct at_cmd_ctx {
    const char *name;           /* Command name (e.g., "GSTAT") */
    uint8_t type;               /* Command type (SET/QUERY/EXEC) */
    const char *args;           /* Arguments string */
    uint8_t transport_type;     /* Transport type for response */
};

/* AT Command Handler */
typedef int (*at_cmd_handler_t)(struct at_cmd_ctx *ctx, char *response, size_t len);

/* AT Command Definition */
struct at_command {
    const char *name;           /* Command name */
    uint8_t flags;              /* Supported operations */
    at_cmd_handler_t handler;   /* Command handler */
};

/**
 * @brief Register an AT command
 *
 * @param cmd Command definition
 * @return 0 on success, negative error code on failure
 */
int at_server_register_cmd(const struct at_command *cmd);

/**
 * @brief Initialize AT server
 *
 * @return 0 on success, negative error code on failure
 */
int at_server_init(void);

/**
 * @brief Submit AT command to server queue
 *
 * @param data Command data
 * @param len Data length
 * @param transport_type Transport type (for response routing)
 * @return 0 on success, negative error code on failure
 */
int at_server_submit_cmd(const uint8_t *data, uint16_t len, uint8_t transport_type);

/**
 * @brief Get error message for error code
 *
 * @param err_code Error code
 * @return Error message string
 */
const char *at_server_err_msg(uint8_t err_code);

#endif /* CLIP_AT_SERVER_H */
```

## include/audio.h
```c
/*
 * Copyright (c) 2025 Seeed Technology Co., Ltd.
 *
 * SPDX-License-Identifier: Apache-2.0
 */

#ifndef AUDIO_H
#define AUDIO_H

#include <stdint.h>
#include <stddef.h>
#include <zephyr/kernel.h>

/**
 * @brief Audio configuration
 */
#define AUDIO_SAMPLE_RATE     16000
#define AUDIO_SAMPLE_BITS      16
#define AUDIO_CHANNELS         2
#define AUDIO_FRAME_MS         20
#define AUDIO_BLOCK_SIZE      (((AUDIO_SAMPLE_BITS / 8) * (AUDIO_SAMPLE_RATE * AUDIO_FRAME_MS)) / 1000) * AUDIO_CHANNELS
#define AUDIO_OPUS_FRAME_SIZE ((AUDIO_SAMPLE_RATE * AUDIO_FRAME_MS) / 1000)
#define AUDIO_MAX_PACKET_SIZE  4000

/* Audio segment duration (from Kconfig) */
#define CLIP_AUDIO_SEGMENT_DURATION_SYNC      CONFIG_CLIP_AUDIO_SEGMENT_DURATION_SYNC
#define CLIP_AUDIO_SEGMENT_DURATION_NO_SYNC   CONFIG_CLIP_AUDIO_SEGMENT_DURATION_NO_SYNC

/**
 * @brief Audio recording modes
 */
enum audio_mode {
	AUDIO_MODE_STEREO = 0,  /* Stereo: record both channels, encode as stereo */
	AUDIO_MODE_MERGE = 1,   /* Enhanced: mix L+R to mono, apply DSP, encode as mono */
};

/**
 * @brief Audio statistics
 */
struct audio_stats {
    uint32_t frames_encoded;
    uint32_t total_bytes;
    uint32_t dropped_frames;
    uint64_t recording_time_ms;
    uint32_t encode_time_min_us;
    uint32_t encode_time_max_us;
    uint32_t encode_time_avg_us;
};

/**
 * @brief Audio data callback
 *
 * Called when encoded audio data is available.
 *
 * @param data Encoded audio data (Opus packet)
 * @param len Length of data in bytes
 * @param user_data User data pointer
 */
typedef void (*audio_data_callback_t)(const uint8_t *data, size_t len, void *user_data);

/**
 * @brief Initialize audio subsystem
 *
 * @return 0 on success, negative error code on failure
 */
int audio_init(void);

/**
 * @brief Cleanup audio subsystem
 */
void audio_cleanup(void);

/**
 * @brief Start audio recording
 *
 * @param mode Audio mode (mono/stereo/merge)
 * @return 0 on success, negative error code on failure
 */
int audio_start_recording(enum audio_mode mode);

/**
 * @brief Stop audio recording
 *
 * @return 0 on success, negative error code on failure
 */
int audio_stop_recording(void);

/**
 * @brief Pause audio recording
 *
 * Pauses recording and writes remaining data to storage.
 *
 * @return 0 on success, negative error code on failure
 */
int audio_pause_recording(void);

/**
 * @brief Resume audio recording
 *
 * Resumes recording with a new session file.
 *
 * @return 0 on success, negative error code on failure
 */
int audio_resume_recording(void);

/**
 * @brief Check if recording is paused
 *
 * @return true if paused, false otherwise
 */
bool audio_is_paused(void);

/**
 * @brief Check if recording is active
 *
 * @return true if recording, false otherwise
 */
bool audio_is_recording(void);

/**
 * @brief Get audio statistics
 *
 * @param stats Output statistics structure
 * @return 0 on success, negative error code on failure
 */
int audio_get_stats(struct audio_stats *stats);

/**
 * @brief Register audio data callback
 *
 * @param callback Callback function
 * @param user_data User data pointer
 */
void audio_register_data_callback(audio_data_callback_t callback, void *user_data);

/**
 * @brief Get current session ID
 *
 * @return Session ID string, or NULL if not recording
 */
const char *audio_get_session_id(void);

/**
 * @brief Audio recording thread
 *
 * @param p1 Unused
 * @param p2 Unused
 * @param p3 Unused
 */
void audio_recording_thread(void *p1, void *p2, void *p3);

/**
 * @brief Get current audio energy level (0-10)
 *
 * Returns the current audio energy level for visualization.
 * Used for display waveform animation.
 *
 * @return Energy level (0 = quiet, 10 = loud)
 */
int audio_get_energy_level(void);

/**
 * @brief Add a bookmark at current recording position
 *
 * Adds a bookmark at the current recording time.
 * Can only be called while recording is active.
 *
 * @return 0 on success, negative error code on failure
 */
int audio_add_bookmark(void);

#endif /* AUDIO_H */
```

## include/audio_crypto.h
```c
/*
 * Cifrado del audio en reposo (Doc 09) — AES-128-GCM por trozos.
 *
 * Formato BPE2 en disco:
 *   cabecera (18 B): "BPE2" | version 0x02 | keyid | nonce_base (12 B)
 *   trozo:           u16-LE len | ciphertext+tag (len bytes, tag = últimos 16)
 *
 * Cada flush del buffer de escritura es un trozo cifrado y autenticado con
 * nonce propio (nonce_base con el contador XOR en los últimos 4 bytes). Por
 * trozos y no de una pieza a propósito: si la batería muere a mitad de
 * fichero, con una sola etiqueta al final se pierde el fichero entero; así
 * solo se pierde el trozo incompleto. Y el GCM de una pieza (one-shot) está
 * garantizado en el acelerador; el multiparte no.
 */

#ifndef CLIP_AUDIO_CRYPTO_H
#define CLIP_AUDIO_CRYPTO_H

#include <stdbool.h>
#include <stdint.h>
#include <stddef.h>
#include <zephyr/fs/fs.h>

struct audio_crypto_ctx {
	bool active;
	uint32_t counter;
	uint8_t nonce_base[12];
};

/** true si hay clave provisionada (AT+KEYCFG) y el cifrado va a aplicarse. */
bool audio_crypto_enabled(void);

/** Invalida la clave PSA cacheada. Llamar cuando AT+KEYCFG cambie la clave. */
void audio_crypto_key_changed(void);

/** Escribe la cabecera BPE2 y prepara el contexto. Falla cerrado: si no se
 *  puede cifrar habiendo clave, el fichero no se crea en claro. */
int audio_crypto_begin(struct audio_crypto_ctx *ctx, struct fs_file_t *f);

/** Cifra `len` bytes como UN trozo y lo escribe (prefijo u16 + ct + tag). */
int audio_crypto_write(struct audio_crypto_ctx *ctx, struct fs_file_t *f,
		       const uint8_t *data, size_t len);

#endif /* CLIP_AUDIO_CRYPTO_H */
```

## include/battery.h
```c
/*
 * Copyright (c) 2025 Seeed Technology Co., Ltd.
 *
 * SPDX-License-Identifier: Apache-2.0
 */

#ifndef CLIP_BATTERY_H
#define CLIP_BATTERY_H

#include <stdbool.h>

/**
 * @brief Initialize battery monitoring
 *
 * Sets up NPM1300 interrupt callbacks for charging events (VBUS, charge complete)
 * and starts periodic battery level polling (60s interval).
 * Updates BLE Battery Service with level and charging status.
 *
 * @return 0 on success, negative error code on failure
 */
int battery_init(void);

/**
 * @brief Poll battery status immediately
 *
 * Reads sensors, updates fuel gauge SoC, and refreshes display/BLE.
 * Call this when the user triggers a status bar display to get fresh readings.
 */
void battery_poll(void);

/**
 * @brief Persist the nRF Fuel Gauge state to settings (LittleFS)
 *
 * Saves the fuel gauge internal state so the SoC is continuous across reboots
 * (without this, every reboot re-estimates SoC from the resting voltage and
 * the displayed % jumps). Called on SoC change (infrequent) + on graceful
 * shutdown/reboot (a fresh copy before power-off).
 */
void battery_save_fg_state(void);

/**
 * @brief Whether VBUS (USB cable power) is present, per the PMIC
 *
 * Cached from the last NPM1300 read; kept fresh by the PMIC's own
 * VBUS_DETECTED/VBUS_REMOVED interrupts. Use this — not the nRF5340 USB
 * controller's VBUS messages, which report a phantom removal whenever the
 * WiFi radio powers on.
 *
 * @return true if a USB cable is powering the device
 */
bool battery_vbus_present(void);

/**
 * @brief Estado interno del gate de carga, para diagnosticar G7 por cable.
 *
 * Tres numeros que hasta ahora habia que deducir del log de la tarjeta — que
 * en produccion es la unica salida y se lee como una foto vieja mientras el
 * aparato la usa. Con esto, "no esta cargando" se resuelve en una consulta:
 *
 *   thermal_off  el latch termico por software tiene la carga apagada. Si es
 *                true, el aparato NO deberia estar cargando y todo va bien.
 *   idle_s       SEGUNDOS que lleva con VBUS puesto y el PMIC sin ver la
 *                celda; 0 si no lo esta. Antes era una cuenta de sondeos, y
 *                era una unidad enganosa: read_and_update() se llama desde
 *                seis sitios, asi que "sondeos" no equivale a minutos.
 *   rearms       intentos de reanimacion del cargador desde el arranque. Si
 *                crece, G7 sigue vivo aunque en el momento de preguntar el
 *                aparato este cargando. OJO: que crezca NO significa que se
 *                haya arreglado nada -- medido el 2026-09-07, ni el ciclo de
 *                habilitacion ni un reinicio del MCU recuperan este fallo;
 *                solo quitar y poner el cable. Ver battery.c.
 */
void battery_charge_gate_state(bool *thermal_off, uint32_t *idle_s,
			       uint32_t *rearms);

#endif /* CLIP_BATTERY_H */
```

## include/ble.h
```c
/*
 * Copyright (c) 2025 Seeed Technology Co., Ltd.
 *
 * SPDX-License-Identifier: Apache-2.0
 */

#ifndef CLIP_BLE_H
#define CLIP_BLE_H

#include <zephyr/bluetooth/bluetooth.h>
#include <zephyr/bluetooth/conn.h>
#include <zephyr/bluetooth/gatt.h>
#include <zephyr/bluetooth/uuid.h>

/* Service UUID: 6E400001-B5A3-F393-E0A9-E50E24DCCA9E */
#define BT_UUID_CLIP_SVC \
    BT_UUID_DECLARE_128(BT_UUID_128_ENCODE(0x6E400001, 0xB5A3, 0xF393, 0xE0A9, 0xE50E24DCCA9E))

/* Characteristic UUID: Command Receive (Write) */
#define BT_UUID_CLIP_CMD_RECV \
    BT_UUID_DECLARE_128(BT_UUID_128_ENCODE(0x6E400002, 0xB5A3, 0xF393, 0xE0A9, 0xE50E24DCCA9E))

/* Characteristic UUID: Response Send (Notify) */
#define BT_UUID_CLIP_RESP_SEND \
    BT_UUID_DECLARE_128(BT_UUID_128_ENCODE(0x6E400003, 0xB5A3, 0xF393, 0xE0A9, 0xE50E24DCCA9E))

/* Characteristic UUID: File Data (Notify) */
#define BT_UUID_CLIP_FILE_DATA \
    BT_UUID_DECLARE_128(BT_UUID_128_ENCODE(0x6E400004, 0xB5A3, 0xF393, 0xE0A9, 0xE50E24DCCA9E))

/* Characteristic UUID: Audio Visualization (Notify) */
#define BT_UUID_CLIP_AUDIO_VIS \
    BT_UUID_DECLARE_128(BT_UUID_128_ENCODE(0x6E400005, 0xB5A3, 0xF393, 0xE0A9, 0xE50E24DCCA9E))

/**
 * @brief BLE context structure
 */
struct ble_context {
    struct bt_conn *conn;
    bool notify_enabled;
    bool file_data_notify_enabled;
    bool audio_vis_notify_enabled;
    char device_name[16];
};

/**
 * @brief Command received callback type
 *
 * @param data Command data
 * @param len Length of data
 * @return 0 on success, negative error code on failure
 */
typedef int (*ble_cmd_callback_t)(const uint8_t *data, uint16_t len);

/**
 * @brief Initialize BLE service
 *
 * @return 0 on success, negative error code on failure
 */
int ble_init(void);

/**
 * @brief Register command callback
 *
 * @param callback Callback function for received commands
 * @return 0 on success, negative error code on failure
 */
int ble_register_cmd_callback(ble_cmd_callback_t callback);

/**
 * @brief Send data via BLE notification (for AT command responses)
 *
 * @param data Data to send
 * @param len Length of data
 * @return 0 on success, negative error code on failure
 */
int ble_send(const uint8_t *data, uint16_t len);

/**
 * @brief Send file data via BLE notification (uses FILE_DATA characteristic)
 *
 * @param data Data to send
 * @param len Length of data
 * @return 0 on success, negative error code on failure
 */
int ble_send_file_data(const uint8_t *data, uint16_t len);

/**
 * @brief Check if BLE is connected
 *
 * @return true if connected, false otherwise
 */
bool ble_is_connected(void);

/**
 * @brief Check if BLE notify is enabled
 *
 * @return true if notify enabled, false otherwise
 */
bool ble_is_notify_enabled(void);

/**
 * @brief Check if file data notify is enabled
 *
 * @return true if file data notify enabled, false otherwise
 */
bool ble_is_file_data_notify_enabled(void);

/**
 * @brief Check if BLE has any bonded devices
 *
 * @return true if at least one bond exists, false otherwise
 */
bool ble_is_bonded(void);

/**
 * @brief Check if audio visualization notifications are subscribed
 *
 * @return true if a BLE client has subscribed to audio_vis characteristic
 */
bool ble_is_audio_vis_subscribed(void);

/**
 * @brief Get address of first bonded device
 *
 * @param addr_buf Buffer to hold address string (min 18 bytes)
 * @param len Buffer length
 * @return 0 on success, -ENOENT if no bonds, -EINVAL if buffer too small
 */
int ble_get_bond_addr(char *addr_buf, size_t len);

/**
 * @brief Clear all BLE bonds
 *
 * @return 0 on success, negative error code on failure
 */
int ble_clear_bonds(void);

/**
 * @brief Rotate the BLE identity address (AT+PAIR=reset)
 *
 * Creates a second local identity (id 1) with a new random address on the
 * first call, or resets id 1 to a new address on later calls. Used so a peer
 * that caches a stale bond (iOS) sees a new device and re-pairs fresh.
 *
 * @return 0 on success, negative error code on failure
 */
int ble_rotate_identity(void);

/**
 * @brief Get BLE connection
 *
 * @return Connection pointer or NULL if not connected
 */
struct bt_conn *ble_get_connection(void);

/**
 * @brief Get negotiated ATT MTU
 *
 * @param conn Connection pointer
 * @return MTU value, or 23 (default) if not connected
 */
uint16_t ble_get_mtu(struct bt_conn *conn);

/**
 * @brief Get device name
 *
 * @return Device name string
 */
const char *ble_get_device_name(void);

/**
 * @brief Restart BLE advertising with fast interval
 *
 * Called on button press to make device quickly discoverable.
 * No-op if already connected.
 */
void ble_adv_restart_fast(void);

/**
 * @brief Refresh BLE inactivity timeout
 *
 * Resets the 5-minute inactivity disconnect timer.
 * Called on AT command reception.
 */
void ble_activity_refresh(void);

/* Zero-copy response buffer size */
#define BLE_RESPONSE_BUFFER_SIZE 1024

/**
 * @brief Get zero-copy response buffer
 *
 * @return Pointer to buffer
 */
char *ble_get_response_buffer(void);

/**
 * @brief Get response buffer size
 *
 * @return Buffer size in bytes
 */
size_t ble_get_response_buffer_size(void);

/**
 * @brief Send response from buffer
 *
 * @param len Length of data to send
 * @return 0 on success, negative error code on failure
 */
int ble_send_response_buffer(size_t len);

/**
 * @brief Send audio visualization data via BLE notification
 *
 * @param data Audio visualization data to send
 * @param len Length of data
 * @return 0 on success, negative error code on failure
 */
int ble_send_audio_vis(const uint8_t *data, uint16_t len);

/**
 * @brief Notify recording state change via BLE
 *
 * Sends JSON event: {"event":"state","state":"<state>","session":"<id>"[,"duration":N]}
 *
 * @param state State string (RECORDING, IDLE, PAUSED)
 * @param session_id Session ID string
 * @param duration Duration in seconds, or -1 if not applicable
 * @return 0 on success, negative error code on failure
 */
int ble_notify_state_change(const char *state, const char *session_id, int duration);

/**
 * @brief Notify bookmark mark event via BLE
 *
 * Sends JSON event: {"event":"mark","session":"<id>","mark_count":N}
 *
 * @param session_id Session ID string
 * @param mark_count Current bookmark count
 * @return 0 on success, negative error code on failure
 */
int ble_notify_mark(const char *session_id, int mark_count);

/**
 * @brief Notify a generic event via BLE
 *
 * Sends JSON event: {"event":"<name>","status":"<status>"}
 *
 * @param name Event name (e.g. "usb", "wifi", "ble")
 * @param status Status string (e.g. "on", "off", "connected", "disconnected")
 * @return 0 on success, negative error code on failure
 */
int ble_notify_event(const char *name, const char *status);

#endif /* CLIP_BLE_H */
```

## include/button.h
```c
/*
 * Copyright (c) 2025 Seeed Technology Co., Ltd.
 *
 * SPDX-License-Identifier: Apache-2.0
 */

#ifndef CLIP_BUTTON_H
#define CLIP_BUTTON_H

#include <zephyr/kernel.h>
#include <zephyr/device.h>
#include <zephyr/drivers/input/button.h>

/**
 * @brief Button event callback
 *
 * Called in button driver thread context - must not block.
 * Use work queue for heavy operations.
 *
 * @param action Button action that occurred
 * @param user_data User data pointer
 */
typedef void (*button_callback_t)(enum button_action action, void *user_data);

/**
 * @brief Initialize button subsystem
 *
 * @return 0 on success, negative error code on failure
 */
int button_init(void);

/**
 * @brief Register button event callback
 *
 * @param callback Callback function
 * @param user_data User data pointer passed to callback
 * @return 0 on success, negative error code on failure
 */
int button_register_callback(button_callback_t callback, void *user_data);

/**
 * @brief Check if button module is ready
 *
 * @return true if ready, false otherwise
 */
bool button_is_ready(void);

#endif /* CLIP_BUTTON_H */
```

## include/ca_builtin.h
```c
/* CA de flota compilada dentro de la imagen firmada. Ver src/ca_builtin.c. */
#ifndef CLIP_CA_BUILTIN_H_
#define CLIP_CA_BUILTIN_H_

#include <stdbool.h>
#include <stddef.h>

extern const char clip_ca_builtin_pem[];
extern const size_t clip_ca_builtin_len;

/** ¿Hay una CA de verdad compilada, o el fichero sigue con el hueco vacio? */
bool clip_ca_builtin_present(void);

#endif /* CLIP_CA_BUILTIN_H_ */
```

## include/clip.h
```c
/*
 * Copyright (c) 2025 Seeed Technology Co., Ltd.
 *
 * SPDX-License-Identifier: Apache-2.0
 */

#ifndef CLIP_H
#define CLIP_H

#include <zephyr/kernel.h>
#include <zephyr/device.h>
#include <zephyr/sys/util.h>
#include <app_version.h>
#include <stdint.h>
#include <stdbool.h>

/* Version string: "X.Y.Z" when TWEAK=0, "X.Y.Z+N" when TWEAK>0. */
#if APP_TWEAK > 0
#define CLIP_VERSION APP_VERSION_TWEAK_STRING
#else
#define CLIP_VERSION APP_VERSION_STRING
#endif

/**
 * @brief Clip error codes
 */
#define CLIP_OK           0
#define CLIP_ERR_INVALID -1
#define CLIP_ERR_BUSY    -2
#define CLIP_ERR_NO_MEM  -3
#define CLIP_ERR_IO      -4
#define CLIP_ERR_TIMEOUT -5

/**
 * @brief Device states
 */
enum clip_state {
    CLIP_STATE_UNINITIALIZED = 0,
    CLIP_STATE_IDLE,
    CLIP_STATE_RECORDING,
    CLIP_STATE_TRANSMITTING,
    CLIP_STATE_WIFI_SYNC,
    CLIP_STATE_PAUSED,
    CLIP_STATE_ERROR,
    CLIP_STATE_OTA,
};

/**
 * @brief Recording modes
 */
enum recording_mode {
    MODE_NORMAL = 0,
    MODE_ENHANCED,
};

/**
 * @brief Event handler callback type
 */
typedef void (*event_handler_t)(int event, void *data);

/**
 * @brief Clip context structure
 *
 * Central structure that holds all application state.
 * This replaces global variables and enables better modularity.
 */
struct clip_context {
    /* Configuration */
    struct clip_config {
        uint8_t mode;               /* Recording mode (normal/enhanced) */
        uint8_t noise_suppress;     /* Noise suppression level (dB) */
        int8_t auto_delete_days;    /* Auto-delete policy: -1=off, 0-30=days */
        bool dereverb_enabled;      /* Dereverberation enabled */
        uint8_t oled_brightness;    /* OLED brightness (0-255) */
        char wifi_password[9];      /* WiFi AP password (8 chars + NUL) */
        char device_name[257];      /* User-defined device name (256 bytes + NUL) */
        uint8_t wifi_channel;       /* WiFi AP channel (default 36) */
        char wifi_reg_domain[3];    /* WiFi regulatory domain (2 chars + NUL, default "US") */
        char sta_ssid[33];          /* WiFi STA: network to join (32 chars + NUL) */
        char sta_psk[65];           /* WiFi STA: WPA2 passphrase or 64-hex PSK (+ NUL) */
        char upload_host[16];       /* Upload service IPv4, dotted quad (+ NUL) */
        uint16_t upload_port;       /* Upload service UDP port */
        uint8_t audio_key[16];      /* AES-128 key for audio-at-rest (all-zero = not set) */
    } config;

    /* Status */
    struct clip_status {
        uint8_t battery_percent;
        bool battery_charging;
        int8_t battery_temp;        /* Battery temperature (°C, NTC) */
        uint16_t battery_mv;        /* Battery voltage (mV) */
        /* Battery current in MICROAMPS, NPM1300 IBAT sense. Sensor
         * convention: negative = discharging, positive = charging.
         *
         * Microamps, not milliamps, and not a style choice: the idle target is
         * 170 uA, which in int16_t milliamps rounds to 0. The whole point of
         * this field is the number it could not represent. Anything below
         * 500 uA read as zero. Recording is in the tens of mA and charging is
         * ~220 mA, so int32_t is needed for the range as well.
         *
         * NOT the total device draw. The nRF7002 taps VBAT upstream of the
         * PMIC, so the radio's current never crosses the IBAT sense resistor
         * and does not appear here. Accurate for idle and for recording with
         * the radio off; blind to WiFi. For absolute figures with the radio
         * on, measure the 3V3 rail externally. See battery.c
         * wifi_load_estimate_a().
         *
         * Whether the PMIC's own IBAT ADC resolves 170 uA is a separate
         * question this field cannot answer. If it reads 0 at idle, the limit
         * is the sensor and the measurement has to move to a PPK. */
        int32_t battery_ua;
        /* Registros crudos del cargador del NPM1300, tal cual, sin decodificar.
         *
         * chg_status: CHGR.STATUS. Los bits que usa battery.c son
         *   BIT(1) COMPLETE, BIT(2) TRICKLE, BIT(3) CC, BIT(4) CV.
         * chg_error:  CHGR.ERR enganchado. Distinto de cero bloquea la carga
         *   aunque EN_SET este escrito, y solo lo limpia ERR_CLR.
         *
         * Se publican en crudo a proposito: la decodificacion completa esta en
         * el datasheet del PMIC, no en este arbol, e inventar nombres para los
         * bits seria peor que dar el numero. Con esto un aparato que "no carga"
         * se diagnostica por cable en un minuto -- que es lo que costo un rato
         * largo por eliminacion cuando no se publicaba nada de esto.
         *
         * vbus_present: presencia de VBUS segun el PMIC, no segun el USB del
         * nRF5340. Son cosas distintas y la que decide si se carga es esta. */
        uint8_t chg_status;
        uint8_t chg_error;
        bool vbus_present;
        uint32_t recording_time;
        uint32_t free_space;
        uint16_t session_count;
    } status;

    /* Time sync */
    struct clip_time {
        uint16_t year;
        uint8_t month;
        uint8_t day;
        uint8_t hour;
        uint8_t min;
        uint8_t sec;
        int64_t base_uptime_ms;
        bool valid;
    } time;
};

/**
 * @brief Get the global clip context
 *
 * @return Pointer to the clip context
 */
struct clip_context *clip_get_context(void);

void clip_cpu_boost_acquire(void);
void clip_cpu_boost_release(void);

/**
 * @brief Initialize clip application
 *
 * @return 0 on success, negative error code on failure
 */
int clip_init(void);

/**
 * @brief Main application loop
 */
void clip_main_loop(void);

/**
 * @brief Get current synchronized time
 *
 * @param out_year Output year
 * @param out_month Output month
 * @param out_day Output day
 * @param out_hour Output hour
 * @param out_min Output minute
 * @param out_sec Output second
 * @return true if time is valid, false otherwise
 */
bool clip_get_current_time(uint16_t *out_year, uint8_t *out_month, uint8_t *out_day,
                           uint8_t *out_hour, uint8_t *out_min, uint8_t *out_sec);

/**
 * @brief Convert state to string
 *
 * @param state State to convert
 * @return String representation
 */
const char *clip_state_to_string(enum clip_state state);

#endif /* CLIP_H */
```

## include/clip_event.h
```c
/*
 * Copyright (c) 2025 Seeed Technology Co., Ltd.
 *
 * SPDX-License-Identifier: Apache-2.0
 *
 * Central event dispatcher for CLIP device.
 *
 * Button presses and AT commands post events here.
 * The event handler validates state transitions, updates state,
 * and triggers all side effects (audio, haptic, display).
 */

#ifndef CLIP_EVENT_H
#define CLIP_EVENT_H

#include <zephyr/kernel.h>
#include "clip.h"

/**
 * @brief Device-level events from user input or AT commands.
 */
enum clip_event {
    CLIP_EVENT_START = 0,
    CLIP_EVENT_STOP,
    CLIP_EVENT_PAUSE,
    CLIP_EVENT_RESUME,
    CLIP_EVENT_MARK,
    CLIP_EVENT_WIFI_ON,
    CLIP_EVENT_WIFI_OFF,
    CLIP_EVENT_POWER_OFF_SHOW,
    CLIP_EVENT_POWER_OFF_EXEC,
    CLIP_EVENT_STATUS_SHOW,
    CLIP_EVENT_USB_CONNECTED,
    CLIP_EVENT_OTA_START,
    CLIP_EVENT_OTA_DONE,
    CLIP_EVENT_COUNT,
};

/**
 * @brief Event result codes
 */
enum clip_event_result {
    CLIP_EVENT_OK = 0,
    CLIP_EVENT_INVALID,
    CLIP_EVENT_BUSY,
    CLIP_EVENT_ERROR,
};

/**
 * @brief Event handler result info (for sync callers)
 */
struct clip_event_result_info {
    enum clip_event_result result;
    int error_code;
};

/**
 * @brief Post an event (non-blocking, for button presses)
 */
int clip_post_event(enum clip_event event);

/**
 * @brief Post an event and wait for result (blocking, for AT commands)
 */
int clip_post_event_sync(enum clip_event event,
                         struct clip_event_result_info *info);

/**
 * @brief Get current device state (thread-safe)
 */
enum clip_state clip_event_get_state(void);

/**
 * @brief Initialize the event dispatcher
 */
int clip_event_init(void);

/**
 * @brief Notify SD activity (re-arms the idle SD power-off timer)
 */
void clip_storage_activity_notify(void);

/**
 * @brief Check if the FS log backend is currently active (AT+LOG on)
 *
 * When active, idle SD power-off is suppressed (logs write to SD).
 */
bool clip_log_fs_active(void);

/**
 * @brief Encender o retirar el log a la tarjeta porque hay un problema.
 *
 * Lo llama la contabilidad de ventanas de http_upload.c: cuando una ventana no
 * logra nada se enciende, y al recuperarse (o al agotar
 * CLIP_LOG_FS_TROUBLE_WINDOWS) se retira.
 *
 * Existe porque los contadores del latido viven en RAM y un reinicio se los
 * lleva -- y reiniciar es justo lo que hace el detector de radio colgada. El
 * log de la tarjeta es lo unico que sobrevive a eso.
 *
 * Una peticion explicita de AT+LOG manda sobre esto: si alguien pidio logs, no
 * se los quitamos; si los apago, no se los volvemos a poner.
 *
 * Ojo: mientras esta activo, clip_sd_busy() es cierto y la tarjeta no duerme.
 */
void clip_log_fs_trouble(bool on);

/**
 * @brief La tarjeta esta encendida por algo que NO es el log.
 *
 * Grabando, transfiriendo, con USB puesto, con un OTA o con un barrido de
 * subida en curso. Se separa de clip_sd_busy() a proposito: el log es una de
 * las condiciones de esa, asi que preguntarle con el log encendido siempre
 * dice que si, y no sirve para decidir si el log sale gratis.
 */
bool clip_sd_busy_other_than_log(void);

/**
 * @brief Reevaluar si el log a la tarjeta debe estar encendido.
 *
 * Lo llama el tick de inactividad de la SD antes de intentar apagarla. Si la
 * tarjeta esta encendida por otra razon, registrar no cuesta corriente y el
 * log se conserva; cuando deja de estarlo, se retira para que la tarjeta pueda
 * dormir.
 */
void clip_log_fs_evaluate(void);

/**
 * @brief Wait for events (called by main loop)
 *
 * Blocks until an event is posted or timeout expires.
 *
 * @param timeout Timeout in milliseconds
 */
void clip_event_wait(k_timeout_t timeout);

/**
 * @brief Process all pending events (called by main loop)
 *
 * Must be called after clip_event_wait() returns.
 * Executes all queued events in order.
 */
void clip_event_process(void);

/**
 * @brief Cancel ongoing OTA (e.g., on BLE disconnect)
 */
void clip_event_ota_cancel(void);

#endif /* CLIP_EVENT_H */
```
