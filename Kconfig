## boards/seeed/clip/board.yml
```yaml
board:
  name: clip
  full_name: reSpeaker Clip
  vendor: seeed
  socs:
  - name: nrf5340
    variants:
    - name: ns
      cpucluster: cpuapp
```

## drivers/Kconfig
```kconfig
# SPDX-License-Identifier: Apache-2.0

# reSpeaker Lav custom drivers configuration

rsource "input/Kconfig"
rsource "display/Kconfig"
```

## lib/Kconfig
```kconfig
# SPDX-License-Identifier: Apache-2.0

# reSpeaker Lav custom libraries configuration

rsource "opus/Kconfig"
rsource "speexdsp/Kconfig"
rsource "lua/Kconfig"
```

## lib/clip_usb_dfu/Kconfig
```kconfig
# SPDX-License-Identifier: Apache-2.0

config CLIP_USB_DFU
	bool "reSpeaker Clip: 1200-baud USB CDC -> mcuboot DFU trigger"
	select REBOOT
	select UART_LINE_CTRL
	select RETAINED_MEM
	select RETENTION
	select RETENTION_BOOT_MODE
	help
	  Standard "open the CDC ACM port at 1200 baud -> reboot into the
	  bootloader" DFU-entry pattern (Arduino/Adafruit/UF2 style). When the
	  host sets the CDC ACM line coding to 1200 baud, the mcuboot boot-mode
	  retention register is set and the device reboots into mcuboot serial
	  recovery (DFU). mcuboot itself does not detect 1200 baud; this is the
	  app-side trigger that drives the existing bootmode_set + recovery flow.

	  Provides clip_usb_dfu_check() for apps that bring their own USB CDC
	  (the clip app, whose USB is BLE-gated). Apps without a USB stack also
	  enable CLIP_USB_DFU_DEFAULT_CDC to get a minimal auto-enabled CDC.

config CLIP_USB_DFU_DEFAULT_CDC
	bool "Default auto-enabled USB CDC ACM for the DFU trigger"
	default y
	depends on CLIP_USB_DFU
	select USB_DEVICE_STACK_NEXT
	select USBD_CDC_ACM_CLASS
	help
	  Adds a minimal CDC ACM interface (Seeed VID) that is auto-initialized
	  and enabled via SYS_INIT, Arduino-style, so apps without their own USB
	  stack (e.g. samples like hello_world) get the 1200-baud DFU trigger
	  with zero code. Apps that bring their own CDC (the clip app, whose USB
	  is BLE-gated via AT+USB=on) set this to n and call clip_usb_dfu_check()
	  from their own USB message callback.
```

## samples/t5838/sample.yaml
```yaml
sample:
  description: T5838 PDM Microphone Test for reSpeaker Lav
  name: t5838
  tests:
    - sample.t5838
```

## tests/dtm/Kconfig
```kconfig
#
# Copyright (c) 2024 Seeed Studio
#
# SPDX-License-Identifier: LicenseRef-Nordic-5-Clause
#

mainmenu "Nordic DTM sample"

config DTM_RADIO_IRQ_PRIORITY
	int "Radio interrupt priority"
	range 0 5 if ZERO_LATENCY_IRQS
	range 0 6
	default 2

config DTM_TIMER_IRQ_PRIORITY
	int "DTM timer interrupt priority"
	range 0 5 if ZERO_LATENCY_IRQS
	range 0 6
	default 3

config DTM_USB
	bool "DTM over USB CDC ACM class [EXPERIMENTAL]"
	depends on SOC_NRF5340_CPUNET && !DTM_TRANSPORT_HCI
	select EXPERIMENTAL

config DTM_TRANSPORT_HCI
	bool "DTM over HCI UART [EXPERIMENTAL]"
	depends on SERIAL
	depends on NET_BUF
	select EXPERIMENTAL

if DTM_TRANSPORT_HCI

config DTM_HCI_QUEUE_COUNT
	int "Count of HCI RX/TX queues"
	default 16

config DTM_HCI_QUEUE_SIZE
	int "Size of HCI RX/TX queue buffer"
	default 1024

config DTM_HCI_TX_THREAD_STACK_SIZE
	int "Stack size of TX thread"
	default 2048

config DTM_HCI_TX_THREAD_PRIORITY
	int "TX thread priority"
	default 7

endif

config DTM_POWER_CONTROL_AUTOMATIC
	bool "Automatic power control"
	depends on FEM
	default y

config DTM_FAST_RAMP_UP
	bool "Enable radio fast ramp up mode"
	default y

module = DTM_TRANSPORT
module-str = "DTM_transport"
source "$(ZEPHYR_BASE)/subsys/logging/Kconfig.template.log_config"

source "Kconfig.zephyr"
```

## tests/dtm/Kconfig.sysbuild
```kconfig
#
# Copyright (c) 2024 Seeed Studio
#
# SPDX-License-Identifier: LicenseRef-Nordic-5-Clause
#

source "${ZEPHYR_BASE}/share/sysbuild/Kconfig"

config NRF_DEFAULT_REMOTE_SHELL
	default y
```

## tests/dtm/boards/clip_nrf5340_cpunet.conf
```kconfig
CONFIG_IPC_UART=y
CONFIG_IPC_SERVICE=y
CONFIG_IPC_SERVICE_BACKEND_RPMSG=y
CONFIG_MBOX=y
CONFIG_HEAP_MEM_POOL_SIZE=4096
```
